/dts-v1/;

/ {

	fragment@0 {
		target = <0xffffffff>;

		__overlay__ {

			camera_pins_cam0_mclk_off {
				phandle = <0x02>;

				pins_cmd_dat {
					pinmux = <0x8100>;
					drive-strength = <0x01>;
				};
			};

			camera_pins_cam0_mclk_2ma {
				phandle = <0x03>;

				pins_cmd_dat {
					pinmux = <0x8101>;
					drive-strength = <0x00>;
				};
			};

			camera_pins_cam0_mclk_4ma {
				phandle = <0x04>;

				pins_cmd_dat {
					pinmux = <0x8101>;
					drive-strength = <0x01>;
				};
			};

			camera_pins_cam0_mclk_6ma {
				phandle = <0x05>;

				pins_cmd_dat {
					pinmux = <0x8101>;
					drive-strength = <0x02>;
				};
			};

			camera_pins_cam0_mclk_8ma {
				phandle = <0x06>;

				pins_cmd_dat {
					pinmux = <0x8101>;
					drive-strength = <0x03>;
				};
			};

			camera_pins_cam1_mclk_off {
				phandle = <0x07>;

				pins_cmd_dat {
					pinmux = <0x7e00>;
					drive-strength = <0x01>;
				};
			};

			camera_pins_cam1_mclk_2ma {
				phandle = <0x08>;

				pins_cmd_dat {
					pinmux = <0x7e01>;
					drive-strength = <0x00>;
				};
			};

			camera_pins_cam1_mclk_4ma {
				phandle = <0x09>;

				pins_cmd_dat {
					pinmux = <0x7e01>;
					drive-strength = <0x01>;
				};
			};

			camera_pins_cam1_mclk_6ma {
				phandle = <0x0a>;

				pins_cmd_dat {
					pinmux = <0x7e01>;
					drive-strength = <0x02>;
				};
			};

			camera_pins_cam1_mclk_8ma {
				phandle = <0x0b>;

				pins_cmd_dat {
					pinmux = <0x7e01>;
					drive-strength = <0x03>;
				};
			};

			camdefault {
				phandle = <0x01>;
			};
		};
	};

	fragment@1 {
		target = <0xffffffff>;

		__overlay__ {
			pinctrl-names = "default", "cam0_mclk_off", "cam0_mclk_2mA", "cam0_mclk_4mA", "cam0_mclk_6mA", "cam0_mclk_8mA", "cam1_mclk_off", "cam1_mclk_2mA", "cam1_mclk_4mA", "cam1_mclk_6mA", "cam1_mclk_8mA";
			pinctrl-0 = <0x01>;
			pinctrl-1 = <0x02>;
			pinctrl-2 = <0x03>;
			pinctrl-3 = <0x04>;
			pinctrl-4 = <0x05>;
			pinctrl-5 = <0x06>;
			pinctrl-6 = <0x07>;
			pinctrl-7 = <0x08>;
			pinctrl-8 = <0x09>;
			pinctrl-9 = <0x0a>;
			pinctrl-10 = <0x0b>;
			cam0_pin_mclk = "mclk";
			cam0_pin_rst = "regulator";
			cam0_pin_vs2pmu = "regulator";
			cam0_pin_vcama = "regulator";
			cam0_pin_vcamd = "regulator";
			cam0_pin_vcamio = "regulator";
			cam0_pin_vcamaf = "regulator";
			cam1_pin_mclk = "mclk";
			cam1_pin_rst = "regulator";
			cam1_pin_vs2pmu = "regulator";
			cam1_pin_vcama = "regulator";
			cam1_pin_vcamd = "regulator";
			cam1_pin_vcamio = "regulator";
			cam0_vcama-supply = <0x0c>;
			cam0_vcamd-supply = <0x0d>;
			cam0_vcamio-supply = <0x0e>;
			cam0_vcamrst-supply = <0x0f>;
			cam0_vcamaf-supply = <0xffffffff>;
			cam1_vcama-supply = <0x10>;
			cam1_vcamd-supply = <0x11>;
			cam1_vcamio-supply = <0x0e>;
			cam1_vcamrst-supply = <0x12>;
			cam0_enable_sensor = "hi5022q_mipi_raw";
			cam1_enable_sensor = "gc13a0ff_mipi_raw";
			camera_input_gpio = <0xffffffff 0x16 0x00>;
			status = "okay";
		};
	};

	fragment@2 {
		target = <0xffffffff>;

		__overlay__ {

			flashlights_aw36515 {
				compatible = "mediatek,flashlights_aw36515";
				aw36515_regulator-supply = <0x13>;
				status = "okay";
				phandle = <0x3a>;
			};

			flashlight_gpio157 {
				compatible = "regulator-fixed";
				regulator-name = "flashlight_gpio157";
				regulator-min-microvolt = <0x1b7740>;
				regulator-max-microvolt = <0x1b7740>;
				gpio = <0xffffffff 0x9d 0x00>;
				enable-active-high;
				phandle = <0x13>;
			};

			cam0vcamio_gpio62 {
				compatible = "regulator-fixed";
				regulator-name = "cam0vcamio_gpio62";
				regulator-min-microvolt = <0x1b7740>;
				regulator-max-microvolt = <0x1b7740>;
				gpio = <0xffffffff 0x3e 0x00>;
				enable-active-high;
				phandle = <0x0e>;
			};

			cam0rst_gpio18 {
				compatible = "regulator-fixed";
				regulator-name = "cam0rst_gpio18";
				regulator-min-microvolt = <0x1b7740>;
				regulator-max-microvolt = <0x1b7740>;
				gpio = <0xffffffff 0x12 0x00>;
				enable-active-high;
				phandle = <0x0f>;
			};

			cam1vcamd_gpio46 {
				compatible = "regulator-fixed";
				regulator-name = "cam1vcamd_gpio46";
				regulator-min-microvolt = <0x1b7740>;
				regulator-max-microvolt = <0x1b7740>;
				gpio = <0xffffffff 0x2e 0x00>;
				enable-active-high;
				phandle = <0x11>;
			};

			cam1rst_gpio16 {
				compatible = "regulator-fixed";
				regulator-name = "cam1rst_gpio16";
				regulator-min-microvolt = <0x1b7740>;
				regulator-max-microvolt = <0x1b7740>;
				gpio = <0xffffffff 0x10 0x00>;
				enable-active-high;
				phandle = <0x12>;
			};
		};
	};

	fragment@3 {
		target = <0xffffffff>;

		__overlay__ {
			status = "okay";
			clock-frequency = <0xf4240>;
			#address-cells = <0x01>;
			#size-cells = <0x00>;

			camera_eeprom0@50 {
				compatible = "mediatek,camera_eeprom";
				reg = <0x50>;
				status = "okay";
				phandle = <0x3b>;
			};

			camera_main@1a {
				compatible = "mediatek,camera_main";
				#thermal-sensor-cells = <0x00>;
				reg = <0x2a>;
				status = "okay";
				phandle = <0x14>;
			};

			camera_main_af@0c {
				compatible = "mediatek,camera_main_af";
				reg = <0x0c>;
				status = "okay";
				phandle = <0x3c>;
			};
		};
	};

	fragment@4 {
		target = <0xffffffff>;

		__overlay__ {
			status = "okay";
			clock-frequency = <0xf4240>;
			#address-cells = <0x01>;
			#size-cells = <0x00>;

			camera_eeprom1@51 {
				compatible = "mediatek,camera_eeprom";
				reg = <0x51>;
				status = "okay";
				phandle = <0x3d>;
			};

			camera_sub@1a {
				compatible = "mediatek,camera_sub";
				#thermal-sensor-cells = <0x00>;
				reg = <0x1a>;
				status = "okay";
				phandle = <0x15>;
			};
		};
	};

	fragment@5 {
		target = <0xffffffff>;

		__overlay__ {

			tran_ldo@28 {
				compatible = "tran,tran_ldo";
				reg = <0x28>;

				regulators {

					TRANLDO13 {
						regulator-name = "TRANLDO13";
						regulator-min-microvolt = <0x927c0>;
						regulator-max-microvolt = <0x1b7740>;
						phandle = <0x0d>;
					};

					TRANLDO23 {
						regulator-name = "TRANLDO23";
						regulator-min-microvolt = <0x927c0>;
						regulator-max-microvolt = <0x1b7740>;
						phandle = <0x1f>;
					};

					TRANLDO33 {
						regulator-name = "TRANLDO33";
						regulator-min-microvolt = <0x124f80>;
						regulator-max-microvolt = <0x325aa0>;
						phandle = <0x0c>;
					};

					TRANLDO43 {
						regulator-name = "TRANLDO43";
						regulator-min-microvolt = <0x124f80>;
						regulator-max-microvolt = <0x325aa0>;
						phandle = <0x10>;
					};
				};
			};
		};
	};

	fragment@6 {
		target = <0xffffffff>;

		__overlay__ {
			#address-cells = <0x01>;
			#size-cells = <0x00>;
			clock-frequency = <0x61a80>;
			mediatek,use-open-drain;

			strobe_main@63 {
				compatible = "mediatek,strobe_main";
				reg = <0x63>;
				status = "okay";
				phandle = <0x3e>;
			};
		};
	};

	fragment@7 {
		target = <0xffffffff>;

		__overlay__ {

			camera_main {
				polling-delay = <0x3e8>;
				polling-delay-passive = <0x00>;
				thermal-sensors = <0x14>;
				phandle = <0x3f>;
			};

			camera_sub {
				polling-delay = <0x3e8>;
				polling-delay-passive = <0x00>;
				thermal-sensors = <0x15>;
				phandle = <0x40>;
			};
		};
	};

	pd_adapter {
		compatible = "mediatek,pd_adapter";
		status = "okay";
		adapter_name = "pd_adapter";
		phandle = <0x41>;
	};

	fragment@8 {
		target = <0xffffffff>;

		__overlay__ {
		};
	};

	fragment@9 {
		target = <0xffffffff>;

		__overlay__ {
			compatible = "mediatek,disp-leds";

			backlight {
				led_mode = <0x04>;
				pwm_config = <0x00 0x01 0x00 0x00 0x00>;
				max-brightness = <0x13ff>;
				max-hw-brightness = <0x13ff>;
				doze_backlight = <0x03 0x02 0x0f 0x1d>;
			};
		};
	};

	fragment@10 {
		target = <0xffffffff>;

		__overlay__ {

			led@6 {
				compatible = "mediatek,lcd-backlight";
				led_mode = <0x04>;
				data = <0x01>;
				pwm_config = <0x00 0x01 0x00 0x00 0x00>;
				phandle = <0x42>;
			};

			fingerprint {
				compatible = "tran_fp";
				interrupt-parent = <0xffffffff>;
				interrupts = <0x0d 0x01 0x0d 0x00>;
				debounce = <0x0d 0x00>;
				pinctrl-names = "tran_fp_default", "tran_fp_pin_irq", "tran_fp_irq_pull_down", "tran_fp_reset_high", "tran_fp_reset_low", "tran_fp_spi_default";
				pinctrl-0 = <0x16>;
				pinctrl-1 = <0x17>;
				pinctrl-2 = <0x18>;
				pinctrl-3 = <0x19>;
				pinctrl-4 = <0x1a>;
				pinctrl-5 = <0x1b>;
				status = "okay";
				phandle = <0x43>;
			};
		};
	};

	fragment@11 {
		target = <0xffffffff>;

		__overlay__ {

			fingerprint@0 {
				compatible = "tran_fp";
				reg = <0x00>;
				spi-max-frequency = <0x2160ec0>;
				interrupt-parent = <0xffffffff>;
				interrupts = <0x0d 0x01 0x0d 0x00>;
				debounce = <0x0d 0x00>;
				irq-gpio = <0x0d>;
				irq-gpio-std = <0xffffffff 0x0d 0x00>;
				reset-gpio = <0x77>;
				reset-gpio-std = <0xffffffff 0x77 0x00>;
				tran,gpio_pwr = <0x3b>;
				tran,gpio_pwr-std = <0xffffffff 0x3b 0x00>;
				anc;
				goodix;
				pinctrl-names = "tran_fp_default", "tran_fp_pin_irq", "tran_fp_irq_pull_down", "tran_fp_reset_high", "tran_fp_reset_low", "tran_fp_spi_default";
				pinctrl-0 = <0x16>;
				pinctrl-1 = <0x17>;
				pinctrl-2 = <0x18>;
				pinctrl-3 = <0x19>;
				pinctrl-4 = <0x1a>;
				pinctrl-5 = <0x1b>;
				status = "okay";
			};
		};
	};

	fragment@12 {
		target = <0xffffffff>;

		__overlay__ {

			fingerprint_default {
				phandle = <0x16>;
			};

			gpio13_eint {
				phandle = <0x17>;

				pins_cmd_dat {
					pinmux = <0xd00>;
					slew-rate = <0x00>;
					bias-disable;
				};
			};

			gpio13_eint_pull_down {
				phandle = <0x18>;

				pins_cmd_dat {
					pinmux = <0xd00>;
					slew-rate = <0x00>;
					bias-pull-down = <0x00>;
					output-low;
				};
			};

			rst_out_one {
				phandle = <0x19>;

				pins_cmd_dat {
					pinmux = <0x7700>;
					slew-rate = <0x01>;
					bias-disable;
					output-high;
				};
			};

			rst_out_zero {
				phandle = <0x1a>;

				pins_cmd_dat {
					pinmux = <0x7700>;
					slew-rate = <0x01>;
					bias-disable;
					output-low;
				};
			};

			spimode_default {
				phandle = <0x1b>;

				pins_cmd_dat {
					pinmux = <0x2d01 0x2b01 0x2c01 0x2a01>;
					drive-strength = <0x07>;
				};
			};
		};
	};

	fragment@13 {
		target = <0xffffffff>;

		__overlay__ {

			lcm_rst_out0_gpio {
				phandle = <0x1c>;

				pins_cmd_dat {
					pinmux = <0x5500>;
					slew-rate = <0x01>;
					output-low;
				};
			};

			lcm_rst_out1_gpio {
				phandle = <0x1d>;

				pins_cmd_dat {
					pinmux = <0x5500>;
					slew-rate = <0x01>;
					output-high;
				};
			};

			lcm_dsi_te {
				phandle = <0x1e>;

				pins_cmd_dat {
					pinmux = <0x5301>;
				};
			};
		};
	};

	fragment@14 {
		target = <0xffffffff>;

		__overlay__ {
			pinctrl-names = "lcm_rst_out0_gpio", "lcm_rst_out1_gpio", "mode_te_te";
			pinctrl-1 = <0x1c>;
			pinctrl-2 = <0x1d>;
			pinctrl-3 = <0x1e>;
			status = "okay";
		};
	};

	fragment@15 {
		target = <0xffffffff>;

		__overlay__ {
			ccorr_prim_force_linear = <0x01>;
		};
	};

	fragment@16 {
		target = <0xffffffff>;

		__overlay__ {
			pinctrl-names = "lcm_rst_out0_gpio", "lcm_rst_out1_gpio", "mode_te_te";
			pinctrl-1 = <0x1c>;
			pinctrl-2 = <0x1d>;
			pinctrl-3 = <0x1e>;
			status = "okay";
			helper-value = <0x00 0x01 0x01 0x01 0x01 0x00 0x01 0x00 0x00 0x00 0x00 0x00 0x01 0x00 0x01 0x01 0x01 0x01 0x00 0x01 0x01 0x01 0x00 0x01 0x00 0x01 0x00 0x00 0x00 0x00 0x01 0x00 0x00 0x00 0x00 0x00 0x01 0x00 0x00 0x01 0x01 0x00 0x01 0x00 0x00 0x00 0x00>;
		};
	};

	fragment@17 {
		target-path = "/low_battery_throttling";

		__overlay__ {
			vbat-thd-enable = <0x01>;
			thd-volts-l = <0xd48 0xce4 0xc80 0xd48 0xce4 0xc80 0xd48 0xce4 0xc80 0xd48 0xce4 0xc80>;
			thd-volts-h = <0xdac 0xd48 0xce4 0xdac 0xd48 0xce4 0xdac 0xd48 0xce4 0xdac 0xd48 0xce4>;
			temperature-max-stage = <0x03>;
			temperature-stage-threshold = <0x19 0x0a 0x00>;
		};
	};

	fragment@18 {
		target = <0xffffffff>;

		__overlay__ {
			compatible = "mediatek,cpu-power-throttling";
			lbat-max-level = <0x03>;
			lbat-limit-freq-lv1 = <0x7fffffff 0x7fffffff 0x7fffffff>;
			lbat-limit-freq-lv2 = <0xdbba0 0xdbba0 0x13d620>;
			lbat-limit-freq-lv3 = <0xdbba0 0xdbba0 0x13d620>;
			oc-max-level = <0x02>;
			oc-limit-freq-lv1 = <0x7fffffff 0x7fffffff 0x7fffffff>;
			oc-limit-freq-lv2 = <0xdbba0 0xdbba0 0x13d620>;
			soc-max-level = <0x01>;
			soc-limit-freq-lv1 = <0x7fffffff 0x7fffffff 0x7fffffff>;
		};
	};

	fragment@19 {
		target = <0xffffffff>;

		__overlay__ {
			compatible = "mediatek,gpu-power-throttling";
			lbat-max-level = <0x03>;
			lbat-limit-freq = <0x7fffffff 0x76688 0x76688>;
			oc-max-level = <0x02>;
			oc-limit-freq = <0x76688 0x76688>;
			soc-max-level = <0x01>;
			soc-limit-freq = <0x7fffffff>;
		};
	};

	fragment@20 {
		target = <0xffffffff>;

		__overlay__ {
			compatible = "mediatek,md-power-throttling";
			lbat-dedicate-volts = <0xe10 0xdac 0xd48 0xce4>;
			lbat-max-level = <0x03>;
			lbat-reduce-tx-lv1 = <0x00>;
			lbat-reduce-tx-lv2 = <0x00>;
			lbat-reduce-tx-lv3 = <0x06>;
		};
	};

	fragment@21 {
		target = <0xffffffff>;

		__overlay__ {
			status = "okay";
			#address-cells = <0x01>;
			#size-cells = <0x00>;

			panel1@0 {
				compatible = "vtdr6126a,fhdp,dsi,vdo,dsc,tm,tm,144hz,km7k";
				reg = <0x00>;
				vddi-gpios = <0xffffffff 0x31 0x00>;
				dvdd-supply = <0x1f>;
				vci-gpios = <0xffffffff 0x3d 0x00>;
				reset-gpios = <0xffffffff 0x55 0x00>;
				pinctrl-names = "default";

				port {

					endpoint {
						remote-endpoint = <0x20>;
						phandle = <0x21>;
					};
				};
			};

			panel2@0 {
				compatible = "nt37706a,fhdp,dsi,vdo,dsc,boe,boe,144hz,km7k";
				reg = <0x01>;
				vddi-gpios = <0xffffffff 0x31 0x00>;
				dvdd-supply = <0x1f>;
				vci-gpios = <0xffffffff 0x3d 0x00>;
				reset-gpios = <0xffffffff 0x55 0x00>;
				pinctrl-names = "default";

				port {

					endpoint {
						remote-endpoint = <0x20>;
						phandle = <0x44>;
					};
				};
			};

			ports {

				port {

					endpoint {
						remote-endpoint = <0x21>;
						phandle = <0x20>;
					};
				};
			};
		};
	};

	fragment@22 {
		target = <0xffffffff>;

		__overlay__ {
			un_als_support = <0x01 0x00 0x00 0x00>;
			ml_lcm_info = <0x38b 0x2a 0x31 0x38>;
			ml_nv_info = <0x01 0x01 0x01>;
			nv_restore_time = <0x03>;
			supplier-num = <0x02>;
			supplier-0 = "vtdr6126a_fhdp_dsi_vdo_dsc_tm_tm_144hz_km7k";
			supplier-1 = "nt37706a_fhdp_dsi_vdo_dsc_boe_boe_144hz_km7k";
		};
	};

	fragment@23 {
		target = <0xffffffff>;

		__overlay__ {
			pwm_ch = <0x02>;
			status = "okay";
		};
	};

	fragment@24 {
		target = <0xffffffff>;

		__overlay__ {

			gps_default {
				phandle = <0x22>;
			};

			gps_l1_lna@0 {
				phandle = <0x23>;

				pins_cmd_dat {
					pinmux = <0x1900>;
					output-low;
				};
			};

			gps_l1_lna@1 {
				phandle = <0x24>;

				pins_cmd_dat {
					pinmux = <0x1902>;
				};
			};

			gps_l1_lna@2 {
				phandle = <0x25>;

				pins_cmd_dat {
					pinmux = <0x1900>;
					output-high;
				};
			};
		};
	};

	fragment@25 {
		target = <0xffffffff>;

		__overlay__ {
			pinctrl-names = "default", "gps_l1_lna_disable", "gps_l1_lna_dsp_ctrl", "gps_l1_lna_enable";
			pinctrl-0 = <0x22>;
			pinctrl-1 = <0x23>;
			pinctrl-2 = <0x24>;
			pinctrl-3 = <0x25>;
			status = "okay";
		};
	};

	fragment@26 {
		target = <0xffffffff>;

		__overlay__ {
			clock-frequency = <0x61a80>;
			status = "okay";

			tms_nfc@28 {
				status = "okay";
				compatible = "tms,nfc";
				reg = <0x28>;
				tms,device-name = "tms_nfc";
				tms,device-count = <0x01>;
				tms,irq-gpio = <0xffffffff 0x01 0x00>;
				tms,ven-gpio = <0xffffffff 0x41 0x00>;
				tms,download-gpio = <0xffffffff 0x08 0x00>;
				phandle = <0x45>;
			};
		};
	};

	fragment@27 {
		target = <0xffffffff>;

		__overlay__ {

			gpio_keys {
				compatible = "gpio-keys";
				status = "disabled";
				phandle = <0x46>;

				aikey {
					label = "Ai_Key";
					linux,code = <0x25d>;
					linux,input-type = <0x01>;
					gpios = <0xffffffff 0x13 0x01>;
					wakeup-source;
					debounce-interval = <0x1e>;
				};
			};
		};
	};

	fragment@28 {
		target = <0xffffffff>;

		__overlay__ {
			supplier-num = <0x02>;
			supplier-vendor-0 = "TM";
			supplier-0 = "vtdr6126a_fhdp_dsi_vdo_dsc_tm_tm_144hz_km7k, chipsemi, chct5560";
			supplier-resolution-0 = <0x10>;
			supplier-vendor-1 = "BOE";
			supplier-vendor-fwname-1 = "focaltech_ts_fw.bin";
			supplier-1 = "nt37706a_fhdp_dsi_vdo_dsc_boe_boe_144hz_km7k, focaltech, ft3682g";
			supplier-resolution-1 = <0x10>;
		};
	};

	fragment@29 {
		target = <0xffffffff>;

		__overlay__ {

			touch@0 {
				compatible = "chipsemi,chsc_cap_touch", "focaltech,fts";
				reg = <0x00>;
				spi-max-frequency = <0xe4e1c0>;
				chipsemi,int-gpio = <0xffffffff 0x0c 0x00>;
				chipsemi,rst-gpio = <0xffffffff 0x74 0x00>;
				chipsemi,vdd-gpio = <0xffffffff 0x96 0x00>;
				chipsemi,vddio-gpio = <0xffffffff 0x0f 0x00>;
				chipsemi,x-coords = <0x437f>;
				chipsemi,y-coords = <0x95ff>;
				chipsemi,multiple-solution = <0x10>;
				chipsemi,fp_x_center = <0x21c>;
				chipsemi,fp_y_center = <0x881>;
				chipsemi,fp_radius = <0x46>;
				chipsemi,fod-function-support;
				chipsemi,pocket-function-support;
				chipsemi,switch-report-support;
				chipsemi,custom-mistouch-support;
				focaltech,irq-gpio = <0xffffffff 0x0c 0x00>;
				focaltech,reset-gpio = <0xffffffff 0x74 0x00>;
				focaltech,iovdd-gpio = <0xffffffff 0x0f 0x00>;
				focaltech,avdd-gpio = <0xffffffff 0x96 0x00>;
				focaltech,max-touch-number = <0x0a>;
				focaltech,display-coords = <0x00 0x00 0x437f 0x95ff>;
				focaltech,pocket-function-support;
				focaltech,fod-function-support;
				focaltech,custom-mistouch-support;
				focaltech,switch-report-support;
				status = "okay";
				chipsemi,rawdata_limits_row = <0x28>;
				chipsemi,rawdata_limits_col = <0x12>;
				chipsemi,short_limits = <0x2bc>;
				invalid_row_col = <0xff 0xff 0xff 0xff 0xff 0xff 0xff 0xff>;
				rawdata_lo_limits = <0xcd0 0x1806 0x1c82 0x1c96 0x1c8f 0x1cb9 0x1cb7 0x1cdf 0x19b0 0x1a00 0x1d48 0x1d05 0x1cfb 0x1ce4 0x1d02 0x1cda 0x1858 0x82f 0x192e 0x1bb1 0x1be7 0x1beb 0x1be7 0x1c0d 0x1c0c 0x1c46 0x16d3 0x1732 0x1ca6 0x1c56 0x1c4d 0x1c31 0x1c46 0x1c2f 0x1beb 0x1f07 0x1cf4 0x1c24 0x1c27 0x1c2e 0x1c2d 0x1c53 0x1c53 0x1c58 0x1c97 0x1d09 0x1cb1 0x1c9d 0x1c92 0x1c7a 0x1c8a 0x1c71 0x1c5c 0x1c10 0x1cd7 0x1c01 0x1c05 0x1c0e 0x1c0c 0x1c38 0x1c37 0x1c37 0x1c36 0x1ca4 0x1c92 0x1c81 0x1c74 0x1c5c 0x1c6d 0x1c50 0x1c3a 0x1bec 0x1cfe 0x1c2e 0x1c36 0x1c3e 0x1c41 0x1c67 0x1c69 0x1c6c 0x1c67 0x1cd5 0x1cc9 0x1cb3 0x1ca8 0x1c8f 0x1c9d 0x1c81 0x1c6b 0x1c1d 0x1d10 0x1c50 0x1c55 0x1c62 0x1c63 0x1c8e 0x1c8c 0x1c90 0x1c89 0x1cfe 0x1ced 0x1cda 0x1cce 0x1cb7 0x1cc2 0x1ca4 0x1c89 0x1c3b 0x1d21 0x1c6e 0x1c73 0x1c82 0x1c87 0x1cb0 0x1cae 0x1cb3 0x1cb0 0x1d21 0x1d0f 0x1cfe 0x1cf1 0x1cd7 0x1ce3 0x1cc6 0x1caa 0x1c59 0x1d0b 0x1c62 0x1c6f 0x1c79 0x1c7a 0x1ca8 0x1ca8 0x1ca9 0x1ca8 0x1d1a 0x1d07 0x1cf5 0x1ce9 0x1ccf 0x1cdc 0x1cbd 0x1ca1 0x1c53 0x1cef 0x1c52 0x1c56 0x1c68 0x1c6c 0x1c96 0x1c98 0x1c99 0x1c98 0x1d09 0x1cfa 0x1ce9 0x1cd8 0x1cbb 0x1cc8 0x1caa 0x1c8f 0x1c42 0x1d0b 0x1c70 0x1c7a 0x1c89 0x1c8d 0x1cb7 0x1cbb 0x1cba 0x1cbc 0x1d2e 0x1d1b 0x1d0c 0x1cfa 0x1cda 0x1ce9 0x1ccd 0x1cae 0x1c60 0x1d06 0x1c70 0x1c78 0x1c8a 0x1c89 0x1cb9 0x1cb8 0x1cc0 0x1cbb 0x1d2f 0x1d20 0x1d05 0x1cf9 0x1cdf 0x1ce9 0x1cc8 0x1cab 0x1c5c 0x1d15 0x1c85 0x1c8c 0x1c9a 0x1ca1 0x1ccc 0x1ccd 0x1cd1 0x1ccf 0x1d44 0x1d2f 0x1d1c 0x1d10 0x1cf1 0x1cfc 0x1cd7 0x1cbf 0x1c6e 0x1d0b 0x1c7e 0x1c87 0x1c97 0x1c94 0x1cc2 0x1ccd 0x1ccc 0x1ccc 0x1d3f 0x1d26 0x1d18 0x1d09 0x1ce9 0x1cf5 0x1cd1 0x1cb7 0x1c67 0x1ced 0x1c60 0x1c62 0x1c74 0x1c71 0x1ca3 0x1ca8 0x1ca8 0x1ca7 0x1d1c 0x1d08 0x1cf7 0x1ce7 0x1cca 0x1cd1 0x1cb3 0x1c97 0x1c47 0x1ce7 0x1c4f 0x1c53 0x1c65 0x1c64 0x1c92 0x1c97 0x1c99 0x1c97 0x1d0e 0x1cf8 0x1ce5 0x1cd7 0x1cb9 0x1cc0 0x1ca3 0x1c83 0x1c31 0x1d04 0x1c60 0x1c60 0x1c72 0x1c6f 0x1c9f 0x1ca3 0x1ca5 0x1ca3 0x1d20 0x1d07 0x1cee 0x1cdd 0x1cbe 0x1cc9 0x1ca3 0x1c87 0x1c37 0x1cf6 0x1c31 0x1c33 0x1c42 0x1c3c 0x1c69 0x1c70 0x1c72 0x1c71 0x1cf9 0x1cce 0x1cbb 0x1cac 0x1c8b 0x1c93 0x1c71 0x1c53 0x1c10 0x1d53 0x1c55 0x1c4e 0x1c5c 0x1c51 0x1c81 0x1c85 0x1c87 0x1c89 0x1d1b 0x1ce5 0x1cd1 0x1cc2 0x1ca3 0x1cae 0x1c8c 0x1c6d 0x1c24 0x1deb 0x1c79 0x1c61 0x1c69 0x1c5d 0x1c8a 0x1c90 0x1c94 0x1c93 0x1d2a 0x1cf0 0x1cda 0x1ccd 0x1caf 0x1cb9 0x1c96 0x1c7b 0x1c38 0x200d 0x1ce7 0x1c9b 0x1c99 0x1c83 0x1cb2 0x1cb7 0x1cbc 0x1cb9 0x1d7b 0x1d2e 0x1d14 0x1d06 0x1cf1 0x1d02 0x1cdf 0x1cc3 0x1ddf 0x1b74 0x1bb6 0x1bcd 0x1bee 0x1c08 0x1c41 0x1c50 0x1c5f 0x1c69 0x1ce7 0x1cda 0x1ccf 0x1ccb 0x1c9f 0x1c97 0x1c83 0x1c76 0x1cea 0x1b9d 0x1be0 0x1bf8 0x1c17 0x1c32 0x1c6b 0x1c7a 0x1c88 0x1c94 0x1d0a 0x1cfe 0x1cf3 0x1cf0 0x1cc2 0x1cbd 0x1ca6 0x1c97 0x1ce7 0x1ba2 0x1be3 0x1bfb 0x1c1b 0x1c33 0x1c6d 0x1c7d 0x1c8a 0x1c94 0x1d0c 0x1cff 0x1cf7 0x1cf3 0x1cc6 0x1cbe 0x1ca9 0x1c99 0x1cde 0x1bb3 0x1bf1 0x1c09 0x1c27 0x1c41 0x1c7c 0x1c89 0x1c98 0x1ca3 0x1d1b 0x1d0e 0x1d05 0x1d00 0x1cd3 0x1ccd 0x1cb6 0x1ca5 0x1ce1 0x1b7c 0x1bbc 0x1bd3 0x1bf0 0x1c09 0x1c41 0x1c50 0x1c5d 0x1c68 0x1cde 0x1cd3 0x1cca 0x1cc6 0x1c9a 0x1c94 0x1c7d 0x1c6d 0x1c9f 0x1b78 0x1bb5 0x1bcb 0x1be9 0x1c01 0x1c37 0x1c47 0x1c55 0x1c60 0x1cd7 0x1cca 0x1cc0 0x1cbd 0x1c92 0x1c8a 0x1c76 0x1c65 0x1c90 0x1b6d 0x1baa 0x1bbe 0x1bdb 0x1bf4 0x1c2c 0x1c39 0x1c48 0x1c53 0x1cca 0x1cbc 0x1cb6 0x1cb2 0x1c86 0x1c7e 0x1c6c 0x1c5a 0x1c7d 0x1b76 0x1bb5 0x1bc9 0x1be1 0x1bfc 0x1c37 0x1c44 0x1c51 0x1c5e 0x1cd5 0x1cc8 0x1cbd 0x1cb9 0x1c8e 0x1c89 0x1c74 0x1c63 0x1c80 0x1b4b 0x1b86 0x1b99 0x1bb5 0x1bcc 0x1c06 0x1c15 0x1c21 0x1c2c 0x1ca3 0x1c98 0x1c8e 0x1c87 0x1c5d 0x1c5a 0x1c44 0x1c35 0x1c51 0x1b6b 0x1ba6 0x1bbb 0x1bd6 0x1bed 0x1c25 0x1c33 0x1c40 0x1c4b 0x1cc3 0x1cb1 0x1cab 0x1ca4 0x1c7a 0x1c78 0x1c65 0x1c54 0x1c6b 0x1b52 0x1b8b 0x1b9e 0x1bb8 0x1bd1 0x1c07 0x1c14 0x1c22 0x1c2c 0x1ca2 0x1c94 0x1c8a 0x1c84 0x1c58 0x1c55 0x1c41 0x1c37 0x1c4e 0x1b48 0x1b7d 0x1b91 0x1baa 0x1bc1 0x1bf8 0x1c01 0x1c12 0x1c1a 0x1c93 0x1c85 0x1c79 0x1c75 0x1c4a 0x1c46 0x1c35 0x1c29 0x1c45 0x1b3a 0x1b6d 0x1b81 0x1b99 0x1baf 0x1be7 0x1bf1 0x1c00 0x1c0a 0x1c85 0x1c76 0x1c6d 0x1c68 0x1c3b 0x1c37 0x1c25 0x1c1d 0x1c40 0x1ae9 0x1b1d 0x1b2f 0x1b49 0x1b60 0x1b93 0x1b9f 0x1bab 0x1bb7 0x1c2f 0x1c21 0x1c19 0x1c12 0x1be7 0x1be5 0x1bd2 0x1bcc 0x1bf9 0x1ae7 0x1b1b 0x1b2b 0x1b44 0x1b5c 0x1b91 0x1b9f 0x1bac 0x1bb3 0x1c2c 0x1c1d 0x1c16 0x1c12 0x1be6 0x1be6 0x1bd5 0x1bcf 0x1c0e 0x1ae5 0x1b1a 0x1b2a 0x1b43 0x1b59 0x1b8d 0x1b9d 0x1ba9 0x1bb1 0x1c2a 0x1c1b 0x1c10 0x1c11 0x1be8 0x1bed 0x1bda 0x1bd6 0x1c36 0x1afd 0x1b2d 0x1b3e 0x1b56 0x1b6b 0x1ba0 0x1bad 0x1bb9 0x1bc2 0x1c38 0x1c2f 0x1c24 0x1c23 0x1bfb 0x1c02 0x1bf2 0x1bf2 0x1c94 0x1abe 0x1af0 0x1aff 0x1b15 0x1b2b 0x1b61 0x1b6b 0x1b79 0x1b84 0x1bfa 0x1bee 0x1be3 0x1be3 0x1bbc 0x1bc2 0x1bb6 0x1bc0 0x1ced 0x17e6 0x1afb 0x1b3a 0x1b4f 0x1b64 0x1b9b 0x1ba8 0x1bb6 0x1bc6 0x1c3c 0x1c2d 0x1c21 0x1c1f 0x1bf4 0x1bfd 0x1bf8 0x1be0 0x1ca2 0xb47 0x18d7 0x1c56 0x1c55 0x1c4a 0x1c9d 0x1d11 0x1d94 0x1e14 0x1e8a 0x1e0d 0x1d88 0x1d21 0x1cd9 0x1d05 0x1d18 0x1a01 0xefb>;
				rawdata_hi_limits = <0x1de4 0x380e 0x3b34 0x3b5c 0x3b4f 0x3ba7 0x3ba3 0x3bf5 0x3bf0 0x3cac 0x3cce 0x3c45 0x3c2f 0x3c00 0x3c3e 0x3bec 0x38ce 0x1317 0x3ac2 0x3981 0x39f1 0x39fb 0x39f3 0x3a41 0x3a3e 0x3ab8 0x3541 0x361e 0x3b7e 0x3ad8 0x3ac5 0x3a8d 0x3ab8 0x3a89 0x39f9 0x4865 0x3c22 0x3a72 0x3a77 0x3a84 0x3a83 0x3ad1 0x3ad1 0x3adc 0x3b61 0x3c4d 0x3b97 0x3b6b 0x3b54 0x3b24 0x3b44 0x3b11 0x3ae6 0x3a48 0x3be3 0x3a27 0x3a31 0x3a44 0x3a40 0x3a9a 0x3a97 0x3a97 0x3a96 0x3b7a 0x3b54 0x3b31 0x3b18 0x3ae6 0x3b09 0x3acc 0x3a9e 0x39fc 0x3c34 0x3a86 0x3a96 0x3aa8 0x3aad 0x3afb 0x3b01 0x3b06 0x3afb 0x3be1 0x3bc7 0x3b9b 0x3b84 0x3b4f 0x3b6d 0x3b33 0x3b05 0x3a61 0x3c5c 0x3acc 0x3ad7 0x3af2 0x3af5 0x3b4e 0x3b48 0x3b52 0x3b43 0x3c36 0x3c11 0x3bec 0x3bd2 0x3ba1 0x3bb8 0x3b7a 0x3b43 0x3aa1 0x3c7f 0x3b0a 0x3b15 0x3b34 0x3b3d 0x3b94 0x3b90 0x3b99 0x3b92 0x3c7f 0x3c59 0x3c34 0x3c19 0x3be5 0x3bfd 0x3bc0 0x3b88 0x3adf 0x3c4f 0x3af2 0x3b0d 0x3b21 0x3b22 0x3b82 0x3b82 0x3b85 0x3b82 0x3c70 0x3c49 0x3c23 0x3c09 0x3bd5 0x3bf0 0x3bad 0x3b75 0x3ad3 0x3c15 0x3ad0 0x3ada 0x3afe 0x3b06 0x3b5c 0x3b62 0x3b65 0x3b62 0x3c4d 0x3c2c 0x3c0b 0x3be8 0x3ba9 0x3bc6 0x3b88 0x3b4f 0x3ab0 0x3c51 0x3b0e 0x3b24 0x3b43 0x3b4b 0x3ba1 0x3bab 0x3ba8 0x3bac 0x3c9a 0x3c71 0x3c54 0x3c2e 0x3bec 0x3c0b 0x3bcf 0x3b90 0x3aec 0x3c46 0x3b10 0x3b1e 0x3b44 0x3b43 0x3ba5 0x3ba4 0x3bb4 0x3ba9 0x3c9b 0x3c7c 0x3c43 0x3c2b 0x3bf5 0x3c0b 0x3bc4 0x3b89 0x3ae4 0x3c65 0x3b3b 0x3b48 0x3b66 0x3b75 0x3bce 0x3bd1 0x3bd9 0x3bd5 0x3cc6 0x3c9b 0x3c74 0x3c5a 0x3c19 0x3c30 0x3be5 0x3bb3 0x3b0a 0x3c51 0x3b2c 0x3b3f 0x3b61 0x3b5a 0x3bb8 0x3bcf 0x3bce 0x3bce 0x3cbb 0x3c88 0x3c6c 0x3c4b 0x3c09 0x3c23 0x3bd7 0x3ba3 0x3afd 0x3c11 0x3aec 0x3af2 0x3b18 0x3b11 0x3b77 0x3b82 0x3b84 0x3b81 0x3c74 0x3c4a 0x3c27 0x3c05 0x3bca 0x3bd9 0x3b9b 0x3b61 0x3ab9 0x3c05 0x3ac9 0x3ad3 0x3af9 0x3af6 0x3b54 0x3b5f 0x3b63 0x3b61 0x3c58 0x3c2a 0x3c01 0x3be3 0x3ba5 0x3bb4 0x3b77 0x3b35 0x3a8d 0x3c42 0x3aee 0x3aee 0x3b12 0x3b0d 0x3b71 0x3b77 0x3b7d 0x3b77 0x3c7c 0x3c47 0x3c14 0x3bf1 0x3bb0 0x3bc7 0x3b79 0x3b3f 0x3a99 0x3c26 0x3a8d 0x3a8f 0x3ab0 0x3aa2 0x3aff 0x3b0e 0x3b12 0x3b11 0x3c2b 0x3bd2 0x3bab 0x3b8a 0x3b47 0x3b57 0x3b11 0x3ad3 0x3a46 0x3ce5 0x3ad5 0x3ac8 0x3ae6 0x3acf 0x3b33 0x3b3b 0x3b3f 0x3b41 0x3c71 0x3c01 0x3bd7 0x3bba 0x3b79 0x3b90 0x3b48 0x3b09 0x3a70 0x3e21 0x3b21 0x3aef 0x3b01 0x3ae7 0x3b44 0x3b50 0x3b58 0x3b57 0x3c90 0x3c18 0x3bec 0x3bcf 0x3b91 0x3ba7 0x3b5e 0x3b25 0x3a9a 0x4291 0x3c07 0x3b67 0x3b63 0x3b35 0x3b98 0x3ba1 0x3bac 0x3ba7 0x3d39 0x3c98 0x3c64 0x3c46 0x3c1b 0x3c3e 0x3bf5 0x3bbb 0x3e09 0x3902 0x398c 0x39bd 0x3a00 0x3a36 0x3aad 0x3acc 0x3aeb 0x3aff 0x3c05 0x3bea 0x3bd3 0x3bcd 0x3b6f 0x3b61 0x3b37 0x3b1c 0x3c0c 0x3957 0x39e2 0x3a16 0x3a57 0x3a8e 0x3b05 0x3b22 0x3b40 0x3b58 0x3c4e 0x3c36 0x3c1f 0x3c18 0x3bb8 0x3bad 0x3b80 0x3b5f 0x3c05 0x3962 0x39eb 0x3a1b 0x3a5d 0x3a91 0x3b09 0x3b29 0x3b46 0x3b5a 0x3c52 0x3c39 0x3c27 0x3c1f 0x3bc0 0x3bb0 0x3b85 0x3b63 0x3bf2 0x3987 0x3a07 0x3a39 0x3a77 0x3aad 0x3b26 0x3b43 0x3b62 0x3b79 0x3c71 0x3c56 0x3c45 0x3c3a 0x3bdd 0x3bd1 0x3ba0 0x3b7d 0x3bf9 0x3914 0x3998 0x39c7 0x3a06 0x3a39 0x3aad 0x3acc 0x3ae7 0x3afe 0x3bf2 0x3bdd 0x3bca 0x3bc0 0x3b66 0x3b58 0x3b2b 0x3b09 0x3b6f 0x390a 0x398b 0x39b9 0x39f5 0x3a29 0x3a99 0x3ab9 0x3ad7 0x3aee 0x3be3 0x3bc8 0x3bb6 0x3baf 0x3b56 0x3b46 0x3b1c 0x3af7 0x3b50 0x38f5 0x3972 0x399e 0x39d9 0x3a0c 0x3a82 0x3a9d 0x3aba 0x3ad3 0x3bc8 0x3bac 0x3ba0 0x3b98 0x3b3c 0x3b2c 0x3b06 0x3ae2 0x3b2b 0x3908 0x3989 0x39b5 0x39e7 0x3a1e 0x3a97 0x3ab4 0x3acf 0x3ae8 0x3be1 0x3bc6 0x3bad 0x3ba7 0x3b4e 0x3b41 0x3b16 0x3af5 0x3b30 0x38af 0x3928 0x3951 0x3989 0x39ba 0x3a32 0x3a53 0x3a6b 0x3a82 0x3b77 0x3b62 0x3b4c 0x3b3f 0x3ae7 0x3ae0 0x3ab4 0x3a93 0x3acd 0x38f1 0x396c 0x3997 0x39ce 0x39fd 0x3a73 0x3a91 0x3aac 0x3ac1 0x3bbb 0x3b95 0x3b89 0x3b7c 0x3b24 0x3b1e 0x3af9 0x3ad4 0x3b05 0x38be 0x3933 0x395a 0x3990 0x39c5 0x3a33 0x3a50 0x3a6c 0x3a80 0x3b76 0x3b5a 0x3b44 0x3b38 0x3ade 0x3ad7 0x3aad 0x3a97 0x3ac8 0x38a8 0x3915 0x393f 0x3974 0x39a3 0x3a14 0x3a29 0x3a4c 0x3a5c 0x3b57 0x3b39 0x3b21 0x3b19 0x3ac0 0x3ab6 0x3a93 0x3a7b 0x3ab5 0x388c 0x38f5 0x391d 0x3951 0x397d 0x39f1 0x3a07 0x3a26 0x3a3c 0x3b3b 0x3b1c 0x3b07 0x3afe 0x3aa1 0x3a99 0x3a73 0x3a61 0x3aaa 0x37e1 0x384f 0x3875 0x38ab 0x38da 0x3945 0x395d 0x3975 0x398f 0x3a87 0x3a6b 0x3a59 0x3a4c 0x39f1 0x39ed 0x39c6 0x39ba 0x3a17 0x37dd 0x3849 0x386b 0x38a0 0x38d2 0x393f 0x395b 0x3976 0x3987 0x3a82 0x3a63 0x3a54 0x3a4c 0x39f0 0x39f0 0x39cd 0x39c1 0x3a42 0x37d9 0x3848 0x386a 0x389d 0x38cb 0x3937 0x3959 0x3971 0x3981 0x3a7c 0x3a5d 0x3a48 0x3a49 0x39f4 0x39fd 0x39d6 0x39d0 0x3a96 0x380b 0x3871 0x3894 0x38c4 0x38f1 0x395e 0x3979 0x3991 0x39a6 0x3a9a 0x3a87 0x3a72 0x3a6f 0x3a1d 0x3a2a 0x3a0a 0x3a0a 0x3b5a 0x3788 0x37f2 0x3811 0x383f 0x386b 0x38db 0x38f1 0x390d 0x3924 0x3a18 0x3a00 0x39e9 0x39eb 0x399a 0x39a6 0x398c 0x39a2 0x3c11 0x37c4 0x3809 0x388a 0x38b5 0x38e2 0x3953 0x3970 0x398c 0x39ac 0x3aa2 0x3a83 0x3a69 0x3a65 0x3a0e 0x3a1f 0x3a16 0x39e4 0x42ce 0x1a51 0x39f7 0x3ad8 0x3ad5 0x3ac0 0x3b6d 0x3c5d 0x3d6e 0x3e76 0x3f6c 0x3e67 0x3d54 0x3c7d 0x3be9 0x3c45 0x3c6a 0x3cad 0x22f5>;
				phandle = <0x47>;
			};
		};
	};

	fragment@30 {
		target = <0xffffffff>;

		__overlay__ {
			interrupts-extended = <0xffffffff 0x05 0x00>;
			status = "disabled";
		};
	};

	fragment@31 {
		target = <0xffffffff>;

		__overlay__ {

			fs15xx_pa@34 {
				compatible = "foursemi,fs15xx";
				reg = <0x34>;
				status = "okay";
			};

			fs15xx_pa@35 {
				compatible = "foursemi,fs15xx";
				reg = <0x35>;
				status = "okay";
			};
		};
	};

	fragment@32 {
		target = <0xffffffff>;

		__overlay__ {
			clock-frequency = <0xf4240>;

			aw20198_led@20 {
				compatible = "awinic,aw20198_led";
				reg = <0x20>;
				enable-gpio = <0xffffffff 0x0a 0x00>;
				aw20198,imax = <0x19>;
				aw20198,sl_current = <0xff>;
				aw20198,max_brightness = <0xff>;
				aw20198,effect-bin;
				ignore_open_circuit_test_cfg_size = <0x14>;
				ignore_open_circuit_test_cfg_reg = <0x00 0x01 0x02 0x05 0x08 0x0b 0x0e 0x11 0x14 0x17 0x1a 0x1b 0x1c 0x1d 0x1e 0x1f 0x20 0x21 0x22 0x23>;
				ignore_open_circuit_test_cfg_val = <0xb7 0x19 0x44 0x3e 0x3e 0x3e 0x3e 0x3e 0x3e 0x3e 0x3e 0x3f 0x3f 0x3f 0x3f 0x3f 0x3f 0x3f 0x3f 0x3f>;
				pinctrl-names = "leds_i2c_clk_mode", "leds_i2c_sda_mode";
				pinctrl-0 = <0x26>;
				pinctrl-1 = <0x27>;
				status = "okay";
			};
		};
	};

	fragment@33 {
		target = <0xffffffff>;

		__overlay__ {

			leds_i2c_clk_mode {
				phandle = <0x26>;

				pins_cmd_dat {
					pinmux = <0x9201>;
					mediatek,drive-strength-adv = <0x00>;
					drive-strength = <0x00>;
					bias-pull-up;
				};
			};

			leds_i2c_sda_mode {
				phandle = <0x27>;

				pins_cmd_dat {
					pinmux = <0x9301>;
					mediatek,drive-strength-adv = <0x00>;
					drive-strength = <0x00>;
					bias-pull-up;
				};
			};
		};
	};

	fragment@34 {
		target = <0xffffffff>;

		__overlay__ {

			was4783@42 {
				status = "ok";
				compatible = "mediatek,was4783-audioswitch";
				reg = <0x42>;
				phandle = <0x48>;
			};
		};
	};

	fragment@35 {
		target = <0xffffffff>;

		__overlay__ {

			tran_audio {
				compatible = "tran_audio,audio";
				typec_usb_change_gpio = <0xffffffff 0x76 0x00>;
				phandle = <0x49>;
			};
		};
	};

	fragment@36 {
		target = <0xffffffff>;

		__overlay__ {
			send_table = <0x00 0x00 0x09 0x03 0x01 0x02 0x04 0x01 0x01 0x05 0x01 0x02 0x06 0x01 0x01 0x1a 0x01 0x09 0x1d 0x02 0x10 0x1f 0x02 0x07 0x29 0x02 0x02 0x2b 0x02 0x0a 0x0e 0x03 0x01 0x0f 0x03 0x02 0x10 0x03 0x01 0x11 0x03 0x06 0x12 0x03 0x02>;
			recv_table = <0x01 0x00 0x02 0x00 0x02 0x00 0x1a 0x00 0x07 0x01 0x02 0x00 0x08 0x01 0x0a 0x00 0x09 0x01 0x01 0x00 0x0a 0x01 0x02 0x00 0x1b 0x01 0x02 0x00 0x1c 0x01 0x05 0x00 0x05 0x01 0x01 0x01 0x1e 0x02 0x02 0x00 0x20 0x02 0x07 0x00 0x2c 0x02 0x0a 0x00 0x14 0x03 0x0a 0x00 0x15 0x03 0x06 0x00 0x16 0x03 0x01 0x00 0x17 0x03 0x02 0x00 0x0f 0x03 0x01 0x01>;
			scp_feature_tbl = <0x00 0x05 0x01 0x01 0x00 0x00 0x02 0x1a 0x00 0x03 0x00 0x00 0x04 0xc8 0x01 0x05 0x00 0x00 0x06 0x78 0x01 0x07 0x0a 0x01 0x08 0x50 0x01 0x09 0x2b 0x01 0x0a 0x16 0x01 0x0b 0x14 0x01 0x0c 0x87 0x01 0x0d 0x2bc 0x00>;
			scp_mem_tbl = <0x00 0x00 0x00 0x01 0x4e300 0x00 0x02 0x100000 0x00 0x03 0x180000 0x00 0x04 0x200000 0x00 0x05 0x5a00 0x00 0x06 0x100 0x00 0x07 0x19000 0x00 0x08 0x10000 0x00 0x09 0x1000 0x00 0x0a 0x2000 0x00 0x0b 0x100 0x00 0x0c 0x100 0x00 0x0e 0x8000 0x00>;
		};
	};

	fragment@37 {
		target = <0xffffffff>;

		__overlay__ {
			pd_vbus_upper_bound = <0x989680>;
		};
	};

	fragment@38 {
		target = <0xffffffff>;

		__overlay__ {
			mediatek,eye-vrt = <0x07>;
			mediatek,eye-term = <0x02>;
			mediatek,rev6 = <0x02>;
			mediatek,discth = <0x0c>;
			mediatek,eye-vrt-host = <0x07>;
			mediatek,eye-term-host = <0x02>;
			mediatek,rev6-host = <0x02>;
		};
	};

	fragment@39 {
		target = <0xffffffff>;

		__overlay__ {

			tran_battery {
				compatible = "tran,chg_fun";
				status = "okay";
				bootmode = <0xffffffff>;
				enable_pcb_tml;
				pcb_temp_step_one = <0x9c40>;
				pcb_cur_step_one = <0x1f4>;
				pcb_temp_step_two = <0xabe0>;
				pcb_cur_step_two = <0x1f4>;
				pcb_min_chg_cur = <0xf4240>;
				jeita_below_neg10_chg_cur = <0x81650>;
				jeita_below_t0_chg_cur = <0x81650>;
				jeita_t0_to_t1_chg_cur = <0x1e8480>;
				jeita_t2_to_t3_chg_cur = <0x1e8480>;
				jeita_t3_to_t4_chg_cur = <0x1e8480>;
				jeita_above_t4_chg_cur = <0x00>;
				jeita_below_neg10_input_chg_cur = <0x1e8480>;
				jeita_below_t0_input_cur = <0x1e8480>;
				jeita_t0_to_t1_input_cur = <0x1e8480>;
				jeita_t2_to_t3_input_cur = <0x200b20>;
				jeita_t3_to_t4_input_cur = <0x200b20>;
				jeita_above_t4_input_cur = <0xf4240>;
				phandle = <0x4a>;
			};

			tran_battery_aging {
				compatible = "tran,chg_aging";
				status = "okay";
				battery_aging_module0 = <0x00>;
				battery_aging_module1 = <0x00>;
				battery_aging_module2 = <0x00>;
				battery_aging_module3 = <0x00>;
				phandle = <0x4b>;
			};

			tran_otg {
				compatible = "tran,otg_fun";
				status = "okay";
				phandle = <0x4c>;
			};

			tran_auto_test {
				compatible = "tran,auto_test";
				status = "okay";
				phandle = <0x4d>;
			};

			pid_chg {
				compatible = "tran,pid_chg_algo";
				pid_array = <0x3e8 0x64 0x2710>;
				polling_interval = <0x2710>;
				power_level = <0x320 0x640 0x960 0xc80 0xfa0>;
				power_delta_temp = <0x00 0x64 0xc8 0x12c 0x12c>;
				power_update_time = <0x12c>;
				power_meas_current = <0x61a80>;
				target_temp_gap = <0x32>;
				steady_cycle = <0x02>;
				max_steady_target_delta_temp = <0x32>;
				max_steady_delta_temp = <0x1e>;
				normal_steady_delta_temp = <0x14>;
				max_unsteady_cnt = <0x02>;
				max_target_temp = <0x1130>;
				ibus_measure_power_update_time = <0x3c>;
				delta_current_max = <0x7a120>;
				phandle = <0x4e>;
			};

			ambient_detect {
				compatible = "transsion,ambient_detect";
				qmax = <0x1324>;
				polling_interval = <0x1a4>;
				ambient_max_power = <0x8ca>;
				ambient_max_temp = <0x258>;
				ambient_min_temp = <0xffffff38>;
				min_detection_duration = <0x12c>;
				ambient_low_power_update_time = <0x4b0>;
				ambient_charging_time = <0x12c>;
				ambient_cooling_time = <0x258>;
				ambient_max_update_time = <0x2a30>;
				ambient_max_temp_rate = <0x384>;
				ambient_max_diff_pcb_temp = <0x32>;
				min_update_soc_diff = <0x28>;
				plug_update_soc_diff = <0x14>;
				power_level = <0x190 0x320 0x4b0 0x640 0x7d0>;
				power_delta_temp = <0x00 0x0a 0x14 0x1e 0x28>;
				phandle = <0x4f>;
			};

			temp_forecast {
				compatible = "transsion,temp_forecast";
				orgin_rate = <0x55>;
				max_temp_diff = <0x96>;
				max_comp_temp = <0x1e>;
				per_rate_time = <0x05>;
				machine_gap = <0x00>;
				phandle = <0x50>;
			};

			port_corrosion {
				compatible = "transsion,port_corrosion";
				phandle = <0x51>;
			};

			phy_insert_det {
				compatible = "transsion,phy_det";
				phy,intr-gpio = <0xffffffff 0x14 0x00>;
				phandle = <0x52>;
			};
		};
	};

	fragment@40 {
		target = <0xffffffff>;

		__overlay__ {
			pe20_ichg_level_threshold = <0xf4240>;
			ta_start_battery_soc = <0x00>;
			ta_stop_battery_soc = <0x5a>;
			min_charger_voltage = <0x4630c0>;
			cable_imp_threshold = <0x2bb>;
			vbat_cable_imp_threshold = <0x3b8260>;
			sc_input_current = <0x1e8480>;
			sc_charger_current = <0x36ee80>;
			dcs_input_current = <0x30d400>;
			dcs_chg1_charger_current = <0x16e360>;
			dcs_chg2_charger_current = <0x16e360>;
			dual_polling_ieoc = <0x6ddd0>;
			slave_mivr_diff = <0x186a0>;
			vbat_threshold = <0x10fe>;
		};
	};

	fragment@41 {
		target = <0xffffffff>;

		__overlay__ {
			tc30_ichg_level_threshold = <0xf4240>;
			ta_start_battery_soc = <0x00>;
			ta_stop_battery_soc = <0x5a>;
			min_charger_voltage = <0x4630c0>;
			cable_imp_threshold = <0x2bb>;
			vbat_cable_imp_threshold = <0x3b8260>;
			sc_input_current = <0x249f00>;
			sc_charger_current = <0x36ee80>;
			vbat_threshold = <0x10fe>;
		};
	};

	fragment@42 {
		target = <0xffffffff>;

		__overlay__ {
			hvdcp20_ichg_level_threshold = <0xf4240>;
			ta_start_battery_soc = <0x00>;
			ta_stop_battery_soc = <0x5a>;
			min_charger_voltage = <0x4630c0>;
			cable_imp_threshold = <0x2bb>;
			vbat_cable_imp_threshold = <0x3b8260>;
			sc_input_current = <0x1e8480>;
			sc_charger_current = <0x36ee80>;
			vbat_threshold = <0x10fe>;
		};
	};

	fragment@43 {
		target = <0xffffffff>;

		__overlay__ {
			pd_vbus_upper_bound = <0x895440>;
			min_charger_voltage = <0x4630c0>;
			sc_input_current = <0x2dc6c0>;
			sc_charger_current = <0x2dc6c0>;
			ibus_err = <0x0e>;
			vsys_watt = <0x4c4b40>;
			vbat_threshold = <0x10fe>;
			pd_stop_battery_soc = <0x55>;
		};
	};

	fragment@44 {
		target = <0xffffffff>;

		__overlay__ {
			compatible = "mediatek,extcon-usb";
			status = "okay";
			charger = <0x28>;
			bootmode = <0xffffffff>;
		};
	};

	fragment@45 {
		target = <0xffffffff>;

		__overlay__ {
			compatible = "mediatek,charger";
			algorithm_name = "Basic";
			charger = <0x28>;
			enable_sw_jeita;
			power_path_support;
			enable_ir_comp;
			r_bat_comp = <0x14>;
			v_comp_max = <0x0f>;
			charger_configuration = <0x03>;
			v_comp_min_step = <0x3e80>;
			ftm_cp_num = <0x01>;
			multi_battery_cv;
			battery_cv = <0x44aa20 0x44aa20 0x44aa20 0x44aa20>;
			max_charger_voltage = <0x632ea0>;
			min_charger_voltage = <0x4630c0>;
			ffc_battery_cv = <0x459480>;
			ffc_eoc = <0x1053b0>;
			non_ffc_eoc = <0x3d090>;
			enable_dynamic_mivr;
			min_charger_voltage_1 = <0x47b760>;
			min_charger_voltage_2 = <0x432380>;
			max_dmivr_charger_current = <0x155cc0>;
			usb_charger_current_suspend = <0x00>;
			usb_charger_current_unconfigured = <0x11170>;
			usb_charger_current_configured = <0x7a120>;
			usb_charger_current = <0x7a120>;
			ac_charger_current = <0x2191c0>;
			ac_charger_input_current = <0x1e8480>;
			non_std_ac_charger_current = <0x124f80>;
			charging_host_charger_current = <0x16e360>;
			apple_1_0a_charger_current = <0x9eb10>;
			apple_2_1a_charger_current = "", "\f5";
			ta_ac_charger_current = <0x36ee80>;
			jeita_temp_above_t4_cv = <0x401640 0x401640 0x401640 0x401640>;
			jeita_temp_t3_to_t4_cv = <0x401640 0x401640 0x401640 0x401640>;
			jeita_temp_t2_to_t3_cv = <0x451f50 0x451f50 0x451f50 0x451f50>;
			jeita_temp_t1_to_t2_cv = <0x451f50 0x451f50 0x451f50 0x451f50>;
			jeita_temp_t0_to_t1_cv = <0x451f50 0x451f50 0x451f50 0x451f50>;
			jeita_temp_below_t0_cv = <0x451f50 0x451f50 0x451f50 0x451f50>;
			jeita_temp_below_neg10_cv = <0x451f50 0x451f50 0x451f50 0x451f50>;
			temp_t4_thres = <0x37>;
			temp_t4_thres_minus_x_degree = <0x33>;
			temp_t3_thres = <0x2d>;
			temp_t3_thres_minus_x_degree = <0x2c>;
			temp_t2_thres = <0x0f>;
			temp_t2_thres_plus_x_degree = <0x10>;
			temp_t1_thres = <0x01>;
			temp_t1_thres_plus_x_degree = <0x01>;
			temp_t0_thres = <0x01>;
			temp_t0_thres_plus_x_degree = <0x01>;
			temp_neg_t1_thres = <0xfffffff6>;
			temp_neg_t1_thres_plus_x_degree = <0xfffffff7>;
			temp_neg_10_thres = <0xffffffef>;
			extreme_low_temp_support;
			enable_min_charge_temp;
			min_charge_temp = <0xffffffed>;
			min_charge_temp_plus_x_degree = <0x01>;
			max_charge_temp = <0x35>;
			max_charge_temp_minus_x_degree = <0x34>;
			enable_high_temp_lock_uisoc;
			io-channels = <0xffffffff 0x05>;
			io-channel-names = "tusb";
			min_tusb_temp = <0xffffff38>;
			max_tusb_temp = <0x258>;
			tusb_div_res = <0x5f370>;
			ambient_temp = <0xfa 0xfa 0xfa 0xfa 0x15e>;
			target_temp_array = <0xfa0 0xfa0 0xfa0 0xfa0 0x10cc>;
			long_life_recharge_en;
			long_life_recharge_time = <0xb4>;
			bat_health_cycle_base = <0x00>;
			bat_health_dec_times = <0x5a>;
			disable_bat_cycle_plug_reset;
			batt_ht_temp = <0x35 0x37 0x3a>;
			batt_ht_rec_temp = <0x00 0x36 0x36>;
			batt_ht_code = <0x00 0x800 0x400>;
			batt_lt_temp = <0xffffffef 0xffffffed 0xffffffed>;
			batt_lt_rec_temp = <0x00 0xffffffef 0xffffffef>;
			batt_lt_code = <0x00 0x00 0x1080>;
			batt_ht_kpoc_temp = <0x35 0x37 0x3a>;
			batt_ht_kpoc_rec_temp = <0x00 0x36 0x36>;
			batt_ht_kpoc_code = <0x00 0x800 0x400>;
			batt_lt_kpoc_temp = <0x00 0xffffffed 0xffffffed>;
			batt_lt_kpoc_rec_temp = <0x00 0xffffffef 0xffffffef>;
			batt_lt_kpoc_code = <0x00 0x00 0x1080>;
			jeita_temp_gap = <0x01>;
			jeita_temp = <0xffffffed 0xfffffff6 0x00 0x0a 0x0f 0x2d 0x32 0x37>;
			jeita_cv = <0x451f50 0x451f50 0x451f50 0x451f50 0x451f50 0x401640 0x401640 0x401640>;
			jeita_eoc = <0x3efd0 0x3efd0 0x3efd0 0x3efd0 0x3efd0 0x3efd0 0x3efd0 0x00>;
			jeita_ichg = <0x7b890 0x7b890 0x1e8480 0x1e8480 0x1e8480 0x1e8480 0x1e8480 0x00>;
			jeita_ilmt = <0x1e8480 0x1e8480 0x1e8480 0x1e8480 0x1e8480 0x1e8480 0x1e8480 0x00>;
			ffc_sw_eoc;
		};
	};

	fragment@46 {
		target = <0xffffffff>;

		__overlay__ {
			compatible = "mediatek,lk_charger";
			enable_anime;
			enable_pe_plus;
			enable_pd20_reset;
			power_path_support;
			max_charger_voltage = <0x632ea0>;
			fast_charge_voltage = <0x231860>;
			usb_charger_current = <0x7a120>;
			ac_charger_current = <0x16e360>;
			ac_charger_input_current = <0x1e8480>;
			non_std_ac_charger_current = <0x124f80>;
			charging_host_charger_current = <0x16e360>;
			ta_ac_charger_current = <0x2dc6c0>;
			pd_charger_current = <0x124f80>;
			cur_threshold = <0x7a120>;
			temp_t0_current = <0x7a120>;
			temp_neg_t0_current = <0x7a120>;
			temp_t4_threshold = <0x38>;
			temp_t3_threshold = <0x2d>;
			temp_t2_threshold = <0x0f>;
			temp_t1_threshold = <0x00>;
			temp_t0_threshold = <0xfffffff6>;
			temp_neg_t0_threshold = <0xffffffec>;
		};
	};

	fragment@47 {
		target = <0xffffffff>;

		__overlay__ {

			upm7610@60 {
				compatible = "up,upm7610";
				reg = <0x60>;
				status = "okay";
				rt-tcpc,name = "type_c_port0";
				rt-tcpc,role_def = <0x05>;
				rt-tcpc,rp_level = <0x00>;
				rt-tcpc,vconn_supply = <0x01>;
				rt-tcpc,notifier_supply_num = <0x03>;
				upm7610pd,intr_gpio = <0xffffffff 0x45 0x00>;
				upm7610pd,intr_gpio_num = <0x45>;

				pd-data {
					pd,vid = <0x362f>;
					pd,pid = <0x7610>;
					pd,source-cap-ext = <0x7610362f 0x00 0x00 0x00 0x00 0x2000000>;
					pd,mfrs = "UnisemipowerTCPC";
					pd,charging_policy = <0x31>;
					pd,source-pdo-size = <0x02>;
					pd,source-pdo-data = <0x19032 0x190c8>;
					pd,sink-pdo-size = <0x01>;
					pd,sink-pdo-data = <0x190c8>;
					pd,id-vdo-size = <0x06>;
					pd,id-vdo-data = <0xd14029cf 0x00 0x17110000 0x41800000 0x00 0x21800000>;
					bat,nr = <0x01>;
					pd,country_nr = <0x00>;

					bat-info0 {
						bat,vid = <0x362f>;
						bat,pid = <0x7610>;
						bat,mfrs = "bat1";
						bat,design_cap = <0xbb8>;
					};
				};

				dpm_caps {
					local_dr_power;
					local_dr_data;
					local_usb_comm;
					local_no_suspend;
					local_vconn_supply;
					attemp_enter_dp_mode;
					attemp_discover_cable;
					attemp_discover_id;
					pr_check = <0x00>;
					dr_check = <0x00>;
				};

				displayport {
					1st_connection = "dfp_d";
					2nd_connection = "dfp_d";
					signal,dp_v13;
					typec,receptacle;

					ufp_d {
					};

					dfp_d {
						pin_assignment,mode_c;
						pin_assignment,mode_d;
						pin_assignment,mode_e;
					};
				};
			};
		};
	};

	fragment@48 {
		target = <0xffffffff>;

		__overlay__ {
			#address-cells = <0x01>;
			#size-cells = <0x00>;
			clock-frequency = <0x186a0>;

			sc8548_master@6F {
				compatible = "sc,sc8548-standalone";
				chg_name = "primary_dvchg";
				reg = <0x6f>;
				sc8548,intr-gpios = <0xffffffff 0x00 0x00>;
				sc,sc8548,bat-ovp-threshold = <0x11ad>;
				sc,sc8548,bat-ocp-threshold = <0x32c8>;
				sc,sc8548,ac-ovp-threshold = <0x2ee0>;
				sc,sc8548,bus-ovp-threshold = <0x2ee0>;
				sc,sc8548,bus-ocp-threshold = <0x1388>;
				sc,sc8548,sense-resistor-mohm = <0x05>;
			};
		};
	};

	fragment@49 {
		target = <0xffffffff>;

		__overlay__ {
			#address-cells = <0x01>;
			#size-cells = <0x00>;

			sc-swchg@6b {
				compatible = "mediatek,sgm41516d", "southchip,sc8950";
				reg = <0x6b>;
				status = "okay";
				sc8950,intr_gpio = <0xffffffff 0x04 0x00>;
				sgm41516d,intr_gpio_num = <0x04>;
				sgm41516d,intr_gpio = <0xffffffff 0x04 0x00>;
				interrupts-extended = <0xffffffff 0x04 0x02>;
				phys = <0xffffffff 0x03>;
				phy-names = "usb2-phy";
				usb = <0xffffffff>;
				chg_name = "primary_chg";
				chg_alias_name = "switch_chg";
				phandle = <0x28>;

				usb-otg-vbus {
					regulator-compatible = "usb-otg-vbus";
					regulator-name = "usb-otg-vbus";
					regulator-min-microvolt = <0x4a0150>;
					regulator-max-microvolt = <0x50df20>;
					regulator-min-microamp = <0x7a120>;
					regulator-max-microamp = <0x124f80>;
					phandle = <0x53>;
				};
			};
		};
	};

	fragment@50 {
		target = <0xffffffff>;

		__overlay__ {
			compatible = "mediatek,extcon-usb";
			charger = <0x28>;
			status = "okay";
		};
	};

	fragment@51 {
		target = <0xffffffff>;

		__overlay__ {
			bc12 = <0x28>;
			bc12_sel = <0x00>;
			status = "okay";
		};
	};

	fragment@52 {
		target = <0xffffffff>;

		__overlay__ {
			charger = <0x28>;
		};
	};

	fragment@53 {
		target = <0xffffffff>;

		__overlay__ {
			charger = <0x28>;
		};
	};

	fragment@54 {
		target = <0xffffffff>;

		__overlay__ {
			#address-cells = <0x01>;
			#size-cells = <0x00>;

			hl7139a_master@5f {
				compatible = "richtek,hl7139a";
				status = "okay";
				reg = <0x5f>;
				rm_name = "hl7139a";
				rm_slave_addr = [5f];
				hl7139a,intr-gpios = <0xffffffff 0x00 0x00>;

				standalone {
					chg_name = "primary_dvchg";
					vbatovp = <0x456d70>;
					ibatocp = <0x8339c0>;
					vbusovp = <0xa7d8c0>;
					ibusocp = <0x419ce0>;
					vinovp = <0xa7d8c0>;
					wdt = <0x2625a00>;
					ibat_rsense = <0x00>;
					i2c_vil_up = <0x01>;
					lt_wd_tmr = <0x03>;
					gpp_conf = <0x00>;
					protocol_i_masked;
					vbat_reg_dis;
					ibat_reg_dis;
					iin_reg_dis;
					tdie_reg_dis;
					ibatocp_dis;
				};
			};
		};
	};

	fragment@55 {
		target = <0xffffffff>;

		__overlay__ {
			compatible = "mediatek,charger,pe5";
			gauge = <0xffffffff>;
			charger = <0x28>;
			polling_interval = <0x2710>;
			ta_cv_ss_repeat_tmin = <0x19>;
			vbat_cv = <0x11d0>;
			judge_cable;
			start_soc_min = <0x00>;
			start_soc_max = <0x5f>;
			start_vbat_max = <0x1162>;
			start_vbat_min = <0xcf8>;
			idvchg_term = <0x28a>;
			ult_lt_vbat_cv = <0x11b2>;
			dv2_support_ult_lt;
			idvchg_step = <0x32>;
			ita_stable_cnt = <0x0a>;
			ita_level = <0xfa0 0x8ca 0x7d0 0x5dc>;
			rcable_level = <0x12c 0x15e 0x1c2 0x226>;
			ita_level_dual = <0x11f8 0xea6 0xd48 0xbb8>;
			rcable_level_dual = <0xfa 0x15e 0x1c2 0x226>;
			idvchg_ss_init = <0x4b0>;
			idvchg_ss_step = <0xfa>;
			idvchg_ss_step1 = <0x64>;
			idvchg_ss_step2 = <0x32>;
			idvchg_ss_step1_vbat = <0xfa0>;
			idvchg_ss_step2_vbat = <0x1068>;
			ta_blanking = <0x190>;
			swchg_aicr = <0x00>;
			swchg_ichg = <0x4b0>;
			swchg_aicr_ss_init = <0x190>;
			swchg_aicr_ss_step = <0xc8>;
			swchg_off_vbat = <0x1068>;
			force_ta_cv_vbat = <0x1068>;
			chg_time_max = <0x8ca0>;
			skip_sw_ibusocp_check;
			judge_vol_diff;
			vol_diff_gap = <0x32>;
			cable_capability_level = <0x00 0x1388 0x1770 0x2328>;
			vol_diff_level = <0x3e8 0x3e8 0x4b0 0x5dc>;
			tta_level_def = <0x00 0x00 0x00 0x00 0x19 0x19 0x19 0x19 0x19 0x19 0x19 0x19 0x19 0x50 0x55 0x5a 0x5f>;
			tta_curlmt = <0x00 0x00 0x00 0x00 0x00 0x00 0x00 0x00 0x00 0x00 0x00 0x00 0x00 0x12c 0x258 0x384 0xffffffff>;
			tta_recovery_area = <0x03>;
			tbat_level_def = <0x00 0x00 0x0a 0x0f 0x19 0x19 0x19 0x19 0x19 0x19 0x19 0x19 0x19 0x19 0x19 0x2c 0x2e>;
			tbat_curlmt = <0xffffffff 0xffffffff 0x00 0x00 0x00 0x00 0x00 0x00 0x00 0x00 0x00 0x00 0x00 0x00 0x00 0x708 0xffffffff>;
			tbat_recovery_area = <0x03>;
			tdvchg_level_def = <0x00 0x00 0x00 0x05 0x19 0x19 0x19 0x19 0x19 0x19 0x19 0x19 0x19 0x46 0x4b 0x50 0x55>;
			tdvchg_curlmt = <0xffffffff 0xffffffff 0xffffffff 0x00 0x00 0x00 0x00 0x00 0x00 0x00 0x00 0x00 0x00 0x12c 0x258 0x384 0xffffffff>;
			tdvchg_recovery_area = <0x03>;
			tswchg_level_def = <0x00 0x00 0x00 0x05 0x19 0x19 0x19 0x19 0x19 0x19 0x19 0x19 0x19 0x41 0x46 0x4b 0x50>;
			tswchg_curlmt = <0xffffffff 0xffffffff 0xffffffff 0x00 0x00 0x00 0x00 0x00 0x00 0x00 0x00 0x00 0x00 0xc8 0x12c 0x190 0xffffffff>;
			tswchg_recovery_area = <0x03>;
			tbat_level_def_0 = <0x00 0x00 0x0a 0x0f 0x19 0x1e 0x21 0x24 0x25 0x26 0x27 0x28 0x29 0x2a 0x2b 0x2c 0x2e>;
			tbat_curlmt_0 = <0xffffffff 0xffffffff 0x00 0x00 0x00 0x00 0x00 0x3e8 0x5dc 0x6a4 0x76c 0x7d0 0x834 0x898 0x9c4 0xbb8 0xffffffff>;
			tbat_level_def_1 = <0x00 0x00 0x0a 0x0f 0x19 0x21 0x22 0x23 0x24 0x25 0x27 0x28 0x29 0x2a 0x2b 0x2c 0x2e>;
			tbat_curlmt_1 = <0xffffffff 0xffffffff 0x00 0x00 0x00 0x00 0x384 0x514 0x640 0x76c 0x834 0x898 0x960 0xa28 0xaf0 0xbb8 0xffffffff>;
			tbat_level_def_2 = <0x00 0x00 0x0a 0x0f 0x19 0x1d 0x1e 0x1f 0x20 0x21 0x22 0x24 0x26 0x28 0x2a 0x2c 0x2e>;
			tbat_curlmt_2 = <0xffffffff 0xffffffff 0x00 0x00 0x00 0x3e8 0x640 0x76c 0x834 0x8fc 0x9c4 0x9c4 0xa28 0xa28 0xaf0 0xc80 0xffffffff>;
			tpcb_level_def_0 = <0x00 0x00 0x00 0x00 0x19 0x1e 0x22 0x25 0x26 0x27 0x28 0x29 0x2a 0x2b 0x2c 0x2d 0x5a>;
			tpcb_curlmt_0 = <0x00 0x00 0x00 0x00 0x00 0x00 0x00 0x3e8 0x5dc 0x6a4 0x76c 0x7d0 0x834 0x898 0x9c4 0xbb8 0xffffffff>;
			tpcb_level_def_2 = <0x00 0x00 0x00 0x00 0x19 0x1d 0x1e 0x1f 0x20 0x21 0x22 0x24 0x26 0x28 0x2a 0x2c 0x5a>;
			tpcb_curlmt_2 = <0x00 0x00 0x00 0x00 0x00 0x3e8 0x640 0x76c 0x834 0x8fc 0x9c4 0x9c4 0xa28 0xa28 0xaf0 0xc80 0xffffffff>;
			tpcb_recovery_area = <0x01>;
			ambient_temp = <0xfa 0x12c 0x15e 0x190>;
			tmachine_level_def_0 = <0x00 0x00 0x00 0x0f 0x19 0x21 0x22 0x23 0x24 0x25 0x27 0x28 0x29 0x2a 0x2b 0x2c 0x50>;
			tmachine_curlmt_0 = <0xffffffff 0x00 0x00 0x00 0x00 0x00 0x384 0x514 0x640 0x76c 0x834 0x898 0x960 0xa28 0xaf0 0xbb8 0xffffffff>;
			tmachine_level_def_1 = <0x00 0x00 0x00 0x0f 0x19 0x21 0x22 0x23 0x24 0x25 0x27 0x28 0x29 0x2a 0x2b 0x2c 0x50>;
			tmachine_curlmt_1 = <0xfffffffe 0x00 0x00 0x00 0x00 0x00 0x384 0x514 0x640 0x76c 0x834 0x898 0x960 0xa28 0xaf0 0xbb8 0xffffffff>;
			tmachine_level_def_2 = <0x00 0x00 0x00 0x0f 0x19 0x21 0x22 0x23 0x24 0x25 0x27 0x28 0x29 0x2a 0x2b 0x2c 0x50>;
			tmachine_curlmt_2 = <0xfffffffd 0x00 0x00 0x00 0x00 0x00 0x384 0x514 0x640 0x76c 0x834 0x898 0x960 0xa28 0xaf0 0xbb8 0xffffffff>;
			tmachine_level_def_3 = <0x00 0x00 0x00 0x0f 0x19 0x21 0x22 0x23 0x24 0x25 0x27 0x28 0x29 0x2a 0x2b 0x2c 0x50>;
			tmachine_curlmt_3 = <0xfffffffc 0x00 0x00 0x00 0x00 0x00 0x384 0x514 0x640 0x76c 0x2f44 0x898 0x960 0xa28 0xaf0 0xbb8 0xffffffff>;
			tmachine_recovery_area = <0x01>;
			sys_power_level_def = <0x00 0x00 0x190 0x320 0x4b0 0x578 0x640 0x7d0 0x960 0xaf0 0xc80 0xe10 0xfa0 0x1130 0x12c0 0x1450 0xc350>;
			sys_power_curlmt = <0xffffffff 0x00 0x00 0x00 0xc80 0xaf0 0x960 0x7d0 0x640 0x4b0 0x4b0 0x4b0 0x4b0 0x4b0 0x4b0 0x4b0 0xffffffff>;
			sys_power_recovery_area = <0x190>;
			dv2_try_dual_threshold = <0x578>;
			dv2_try_third_threshold = <0xdac>;
			ifod_threshold = <0xc8>;
			rsw_min = <0x14>;
			ircmp_rbat = <0x0a>;
			ircmp_vclamp = <0x0a>;
			vta_cap_min = <0x1a90>;
			vta_cap_max = <0x2904>;
			ita_cap_min = <0x3e8>;
			project_power = <0x2d>;
			support_ta = "rfc_adapter", "pd_adapter";
			allow_not_check_ta_status;
			rechg_ab_h = <0x2c 0xffffffff 0xffffffff 0xffffffff 0xffffffff 0xffffffff>;
			rechg_ab_l = <0x02 0xffffffff 0xffffffff 0xffffffff 0xffffffff 0xffffffff>;
			dv2_ab_dev = <0x00 0x00 0x00 0x00 0x00 0x00>;
			dv2_ffc_vbat = <0x1068 0x1194 0x11b2 0x11d0 0x11d0>;
			dv2_ffc_ibat = <0xfa0 0xcd9 0x9e2 0x6eb 0x6eb>;
			dv2_ffc_vbat_low = <0x1068 0x1068 0x1068 0x1068>;
			dv2_ffc_ibat_low = <0xfa0 0xfa0 0xfa0 0xfa0>;
			dv2_ffc_vbat_mid = <0x1194 0x1194 0x1194 0x1194>;
			dv2_ffc_ibat_mid = <0xcd9 0xcd9 0xcd9 0xcd9>;
			dv2_ffc_vbat_high = <0x11b2 0x11b2 0x11b2 0x11b2>;
			dv2_ffc_ibat_high = <0x9e2 0x9e2 0x9e2 0x9e2>;
			dv2_ffc_vbat_high_ext1 = <0x11d0 0x11d0 0x11d0 0x11d0>;
			dv2_ffc_ibat_high_ext1 = <0x6eb 0x6eb 0x6eb 0x6eb>;
			dv2_ffc_vbat_high_ext2 = <0x11d0 0x11d0 0x11d0 0x11d0>;
			dv2_ffc_ibat_high_ext2 = <0x6eb 0x6eb 0x6eb 0x6eb>;
			dv2_ffc_vbat_low_lt = <0x1068 0x1068 0x1068 0x1068>;
			dv2_ffc_ibat_low_lt = <0xfa0 0xfa0 0xfa0 0xfa0>;
			dv2_ffc_vbat_mid_lt = <0x1194 0x1194 0x1194 0x1194>;
			dv2_ffc_ibat_mid_lt = <0xcd9 0xcd9 0xcd9 0xcd9>;
			dv2_ffc_vbat_high_lt = <0x11b2 0x11b2 0x11b2 0x11b2>;
			dv2_ffc_ibat_high_lt = <0x9e2 0x9e2 0x9e2 0x9e2>;
			dv2_ffc_vbat_high_ext1_lt = <0x11d0 0x11d0 0x11d0 0x11d0>;
			dv2_ffc_ibat_high_ext1_lt = <0x6eb 0x6eb 0x6eb 0x6eb>;
			dv2_ffc_vbat_high_ext2_lt = <0x11d0 0x11d0 0x11d0 0x11d0>;
			dv2_ffc_ibat_high_ext2_lt = <0x6eb 0x6eb 0x6eb 0x6eb>;
			dv2_ffc_temp_level_def = <0x0f 0x23>;
			dv2_ffc_vbat_low_mint = <0x11b2 0x11b2 0x11b2 0x11b2>;
			dv2_ffc_ibat_low_mint = <0x9e2 0x9e2 0x9e2 0x9e2>;
			dv2_ffc_vbat_mid_mint = <0x11b2 0x11b2 0x11b2 0x11b2>;
			dv2_ffc_ibat_mid_mint = <0x9e2 0x9e2 0x9e2 0x9e2>;
			dv2_ffc_vbat_high_mint = <0x11b2 0x11b2 0x11b2 0x11b2>;
			dv2_ffc_ibat_high_mint = <0x9e2 0x9e2 0x9e2 0x9e2>;
			dv2_ffc_vbat_high_ext1_mint = <0x11b2 0x11b2 0x11b2 0x11b2>;
			dv2_ffc_ibat_high_ext1_mint = <0x9e2 0x9e2 0x9e2 0x9e2>;
			dv2_ffc_vbat_high_ext2_mint = <0x11b2 0x11b2 0x11b2 0x11b2>;
			dv2_ffc_ibat_high_ext2_mint = <0x9e2 0x9e2 0x9e2 0x9e2>;
			dv2_ffc_ult_lt_level = <0x0a 0x00 0x00 0x00>;
			dv2_ffc_vbat_low_ult_lt_0 = <0x11b2 0x11b2 0x11b2 0x11b2>;
			dv2_ffc_vbat_mid_ult_lt_0 = <0x11b2 0x11b2 0x11b2 0x11b2>;
			dv2_ffc_vbat_high_ult_lt_0 = <0x11b2 0x11b2 0x11b2 0x11b2>;
			dv2_ffc_ibat_low_ult_lt_0 = <0x9e2 0x9e2 0x9e2 0x9e2>;
			dv2_ffc_ibat_mid_ult_lt_0 = <0x9e2 0x9e2 0x9e2 0x9e2>;
			dv2_ffc_ibat_high_ult_lt_0 = <0x9e2 0x9e2 0x9e2 0x9e2>;
			dv2_ffc_vbat_low_ult_lt_1 = <0x11b2 0x11b2 0x11b2 0x11b2>;
			dv2_ffc_vbat_mid_ult_lt_1 = <0x11b2 0x11b2 0x11b2 0x11b2>;
			dv2_ffc_vbat_high_ult_lt_1 = <0x11b2 0x11b2 0x11b2 0x11b2>;
			dv2_ffc_ibat_high_ult_lt_1 = <0x4f1 0x4f1 0x4f1 0x4f1>;
			dv2_ffc_ibat_low_ult_lt_1 = <0x4f1 0x4f1 0x4f1 0x4f1>;
			dv2_ffc_ibat_mid_ult_lt_1 = <0x4f1 0x4f1 0x4f1 0x4f1>;
			idvchg_pps_term = <0x4b0>;
			lcd_on_ita = <0x1068>;
			pe50_call_ita = <0x7d0>;
			pe5_ffc_gap = <0x14 0x14 0x14 0x14>;
			step_ffc_level = <0x0c>;
			step_ffc_level_0 = <0x00 0x0a 0x11b2 0x11b2 0x11b2 0x11b2 0x9e2 0x9e2 0x9e2 0x9e2 0x4b0 0xffffffff 0xffffffff 0x00 0x00>;
			step_ffc_level_1 = <0x0a 0x0f 0x11b2 0x11b2 0x11b2 0x11b2 0x13c4 0x13c4 0x13c4 0x13c4 0x4b0 0xffffffff 0xffffffff 0x00 0x00>;
			step_ffc_level_2 = <0x0f 0x23 0x1068 0x1194 0x11b2 0x11d0 0x1f40 0x19b2 0x13c4 0xdd6 0x5aa 0x00 0xc8 0x01 0x9c4>;
			step_ffc_level_3 = <0x23 0x2d 0x1068 0x1194 0x11b2 0x11d0 0x1f40 0x19b2 0x13c4 0xdd6 0x84d 0x00 0xc8 0x14 0x9c4>;
			step_ffc_level_4 = <0x0f 0x23 0x1068 0x1180 0x119e 0x11bc 0x1f40 0x19b2 0x13c4 0xdd6 0x5aa 0xc8 0x12c 0x14 0x9c4>;
			step_ffc_level_5 = <0x23 0x2d 0x1068 0x1180 0x119e 0x11bc 0x1f40 0x19b2 0x13c4 0xdd6 0x84d 0xc8 0x12c 0x28 0x9c4>;
			step_ffc_level_6 = <0x0f 0x23 0x1068 0x116c 0x118a 0x11a8 0x1f40 0x19b2 0x13c4 0xdd6 0x5aa 0x12c 0x1f4 0x28 0x9c4>;
			step_ffc_level_7 = <0x23 0x2d 0x1068 0x116c 0x118a 0x11a8 0x1f40 0x19b2 0x13c4 0xdd6 0x84d 0x12c 0x1f4 0x3c 0x9c4>;
			step_ffc_level_8 = <0x0f 0x23 0x1068 0x1158 0x1176 0x1194 0x1f40 0x19b2 0x13c4 0xdd6 0x5aa 0x1f4 0x3e8 0x3c 0x9c4>;
			step_ffc_level_9 = <0x23 0x2d 0x1068 0x1158 0x1176 0x1194 0x1f40 0x19b2 0x13c4 0xdd6 0x84d 0x1f4 0x3e8 0x50 0x9c4>;
			step_ffc_level_10 = <0x0f 0x23 0x1068 0x1126 0x1144 0x1162 0x1f40 0x19b2 0x13c4 0xdd6 0x5aa 0x3e8 0xffffffff 0x6e 0x9c4>;
			step_ffc_level_11 = <0x23 0x2d 0x1068 0x1126 0x1144 0x1162 0x1f40 0x19b2 0x13c4 0xdd6 0x84d 0x3e8 0xffffffff 0x82 0x9c4>;
		};
	};

	fragment@56 {
		target = <0xffffffff>;

		__overlay__ {

			aw2023@45 {
				compatible = "awinic,aw2023_led";
				reg = <0x45>;
				status = "okay";

				aw2023,led {
					aw2023,name = "aw2023_led";
					aw2023,imax = <0x02>;
					aw2023,brightness = <0x80>;
					aw2023,max_brightness = <0xff>;
				};
			};
		};
	};

	fragment@57 {
		target = <0xffffffff>;

		__overlay__ {

			usb_control {
				compatible = "transsion, usb_control";
				status = "okay";
				switch_control_type = <0x01>;
				rfc_control_type = <0x01>;
				ta_control_type = <0x00>;
				tc30_by_switch_ic_oneshot;
				pinctrl-names = "default", "hvdcp_handshake", "hvdcp_boost_5v", "hvdcp_boost_9v", "hvdcp_reset", "tc30_handshake", "tc30_reset", "rfc_i2c_mode", "rfc_dual_high", "rfc_high_low", "rfc_reset", "rfc_usb_switch_on", "rfc_usb_switch_off", "ta_off", "ta_reset";
				pinctrl-0 = <0x29>;
				pinctrl-1 = <0x2a>;
				pinctrl-2 = <0x2b>;
				pinctrl-3 = <0x2c>;
				pinctrl-4 = <0x2d>;
				pinctrl-5 = <0x2e>;
				pinctrl-6 = <0x2f>;
				pinctrl-7 = <0x30>;
				pinctrl-8 = <0x31>;
				pinctrl-9 = <0x32>;
				pinctrl-10 = <0x33>;
				pinctrl-11 = <0x34>;
				pinctrl-12 = <0x35>;
				pinctrl-13 = <0x36>;
				pinctrl-14 = <0x37>;
				phandle = <0x54>;
			};
		};
	};

	fragment@58 {
		target = <0xffffffff>;

		__overlay__ {

			default {
				phandle = <0x29>;
			};

			hvdcp_handshake {
				phandle = <0x2a>;
			};

			hvdcp_boost_5v {
				phandle = <0x2b>;
			};

			hvdcp_boost_9v {
				phandle = <0x2c>;
			};

			hvdcp_reset {
				phandle = <0x2d>;
			};

			tc30_handshake {
				phandle = <0x2e>;
			};

			tc30_reset {
				phandle = <0x2f>;
			};

			rfc_i2c_mode {
				phandle = <0x30>;
			};

			rfc_dual_high {
				phandle = <0x31>;
			};

			rfc_high_low {
				phandle = <0x32>;
			};

			rfc_reset {
				phandle = <0x33>;
			};

			usb_switch_on {
				phandle = <0x34>;
			};

			usb_switch_off {
				phandle = <0x35>;
			};

			ta_off {
				phandle = <0x36>;
			};

			ta_reset {
				phandle = <0x37>;
			};
		};
	};

	fragment@59 {
		target = <0xffffffff>;

		__overlay__ {
			#address-cells = <0x01>;
			#size-cells = <0x00>;
			clock-frequency = <0x61a80>;
			mediatek,use-open-drain;

			usb_type_c@4e {
				compatible = "mediatek,usb_type_c";
				reg = <0x4e>;
				status = "okay";
				rt-tcpc,name = "type_c_port0";
				rt-tcpc,role_def = <0x05>;
				rt-tcpc,rp_level = <0x02>;
				rt-tcpc,vconn_supply = <0x01>;
				rt-tcpc,notifier_supply_num = <0x03>;
				rt1711pd,intr_gpio = <0xffffffff 0x45 0x00>;
				rt1711pd,intr_gpio_num = <0x45>;
				phandle = <0x55>;

				pd-data {
					pd,vid = <0x29cf>;
					pd,pid = <0x1711>;
					pd,source-cap-ext = <0x171129cf 0x00 0x00 0x00 0x00 0x2000000>;
					pd,mfrs = "RichtekTCPC";
					pd,charging_policy = <0x31>;
					pd,source-pdo-size = <0x02>;
					pd,source-pdo-data = <0x19032 0x190c8>;
					pd,sink-pdo-size = <0x01>;
					pd,sink-pdo-data = <0x190c8>;
					pd,id-vdo-size = <0x06>;
					pd,id-vdo-data = <0xd14029cf 0x00 0x17110000 0x41800000 0x00 0x21800000>;
					bat,nr = <0x01>;
					pd,country_nr = <0x00>;

					bat-info0 {
						bat,vid = <0x29cf>;
						bat,pid = <0x1711>;
						bat,mfrs = "bat1";
						bat,design_cap = <0xbb8>;
					};
				};

				dpm_caps {
					local_dr_power;
					local_dr_data;
					local_usb_comm;
					local_no_suspend;
					local_vconn_supply;
					attemp_enter_dp_mode;
					attemp_discover_cable;
					attemp_discover_id;
					pr_check = <0x00>;
					dr_check = <0x00>;
				};

				displayport {
					1st_connection = "dfp_d";
					2nd_connection = "dfp_d";
					signal,dp_v13;
					typec,receptacle;

					ufp_d {
					};

					dfp_d {
						pin_assignment,mode_c;
						pin_assignment,mode_d;
						pin_assignment,mode_e;
					};
				};
			};
		};
	};

	fragment@60 {
		target = <0xffffffff>;

		__overlay__ {

			usb_switch {
				compatible = "tran,usb_switch";
				switch_built_in_ic;
				status = "okay";
				phandle = <0x56>;
			};

			pca_rfc_ta {
				compatible = "richtek,pca_rfc_ta";
				status = "okay";
				adapter_name = "rfc_adapter";
				vta_step = <0x28>;
				ita_step = <0x1e>;
				ita_gap_per_vstep = <0x14>;
				ita_gap_cv_mode = <0x64>;
				pwr_lmt;
				support_meas_cap;
				support_status;
			};
		};
	};

	fragment@61 {
		target = <0xffffffff>;

		__overlay__ {
			clock-frequency = <0x186a0>;

			rfc_ta@1b {
				compatible = "richtek,rfc_ta";
				reg = <0x1b>;
				pinctrl-names = "i2c_sclk_mode", "i2c_sda_mode";
				pinctrl-0 = <0x38>;
				pinctrl-1 = <0x39>;
				status = "okay";
			};
		};
	};

	fragment@62 {
		target = <0xffffffff>;

		__overlay__ {

			i2c_sclk_mode {
				phandle = <0x38>;

				pins_cmd_dat {
					pinmux = <0x9001>;
					bias-pull-up = <0xcd>;
					mediatek,drive-strength-adv = <0x00>;
					drive-strength = <0x03>;
				};
			};

			i2c_sda_mode {
				phandle = <0x39>;

				pins_cmd_dat {
					pinmux = <0x9101>;
					bias-pull-up = <0xcd>;
					mediatek,drive-strength-adv = <0x00>;
					drive-strength = <0x03>;
				};
			};
		};
	};

	fragment@63 {
		target = <0xffffffff>;

		__overlay__ {

			adc_channel@ {
				compatible = "mediatek,adc_channel";
				mediatek,adc_fdd_rf_params_dynamic_custom_ch = <0x02>;
				status = "okay";
			};
		};
	};

	fragment@64 {
		target = <0xffffffff>;

		__overlay__ {
			GPIO_SIM1_HOT_PLUG = <0xffffffff 0x17 0x00>;
			GPIO_SIM1_SCLK = <0xffffffff 0x4d 0x00>;
			GPIO_SIM1_SRST = <0xffffffff 0x4e 0x00>;
			GPIO_SIM1_SIO = <0xffffffff 0x4f 0x00>;
			GPIO_SIM2_SCLK = <0xffffffff 0x50 0x00>;
			GPIO_SIM2_SRST = <0xffffffff 0x51 0x00>;
			GPIO_SIM2_SIO = <0xffffffff 0x52 0x00>;
		};
	};

	fragment@65 {
		target = <0xffffffff>;

		__overlay__ {
			gpio_init_default = <0x00 0x00 0x00 0x00 0x01 0x01 0x01 0x01 0x00 0x00 0x00 0x01 0x00 0x00 0x02 0x00 0x00 0x00 0x01 0x00 0x01 0x03 0x00 0x00 0x00 0x01 0x01 0x01 0x04 0x00 0x00 0x00 0x01 0x01 0x01 0x05 0x00 0x00 0x00 0x01 0x00 0x00 0x06 0x00 0x00 0x00 0x01 0x01 0x00 0x07 0x00 0x00 0x00 0x01 0x01 0x01 0x08 0x00 0x00 0x00 0x01 0x01 0x01 0x09 0x00 0x00 0x00 0x01 0x01 0x01 0x0a 0x00 0x01 0x00 0x01 0x00 0x01 0x0b 0x00 0x00 0x00 0x01 0x01 0x01 0x0c 0x00 0x00 0x00 0x00 0x00 0x01 0x0d 0x00 0x00 0x00 0x01 0x00 0x00 0x0e 0x00 0x00 0x00 0x01 0x01 0x00 0x0f 0x00 0x01 0x00 0x01 0x00 0x00 0x10 0x00 0x01 0x00 0x01 0x00 0x00 0x11 0x00 0x01 0x00 0x01 0x00 0x00 0x12 0x00 0x01 0x00 0x01 0x00 0x00 0x13 0x00 0x01 0x00 0x01 0x00 0x00 0x14 0x00 0x00 0x00 0x00 0x00 0x00 0x15 0x00 0x01 0x00 0x01 0x00 0x00 0x16 0x00 0x00 0x00 0x00 0x00 0x00 0x17 0x01 0x00 0x00 0x01 0x01 0x00 0x18 0x00 0x00 0x00 0x01 0x00 0x00 0x19 0x00 0x01 0x00 0x01 0x00 0x01 0x1a 0x00 0x01 0x00 0x01 0x00 0x01 0x1b 0x01 0x01 0x00 0x01 0x00 0x01 0x1c 0x01 0x00 0x00 0x01 0x01 0x01 0x1d 0x01 0x00 0x00 0x00 0x00 0x01 0x1e 0x02 0x00 0x00 0x01 0x00 0x00 0x1f 0x02 0x00 0x00 0x01 0x00 0x00 0x20 0x02 0x00 0x00 0x01 0x00 0x00 0x21 0x02 0x00 0x00 0x01 0x00 0x00 0x22 0x01 0x00 0x00 0x01 0x01 0x00 0x23 0x01 0x00 0x00 0x01 0x01 0x00 0x24 0x01 0x00 0x00 0x01 0x00 0x00 0x25 0x01 0x00 0x00 0x01 0x00 0x00 0x26 0x02 0x00 0x00 0x00 0x00 0x01 0x27 0x02 0x00 0x00 0x00 0x00 0x01 0x28 0x02 0x00 0x00 0x00 0x00 0x01 0x29 0x02 0x00 0x00 0x01 0x00 0x01 0x2a 0x01 0x01 0x00 0x01 0x00 0x00 0x2b 0x00 0x01 0x00 0x01 0x00 0x00 0x2c 0x00 0x01 0x00 0x01 0x00 0x00 0x2d 0x01 0x00 0x00 0x01 0x00 0x00 0x2e 0x01 0x01 0x00 0x00 0x00 0x01 0x2f 0x01 0x01 0x00 0x00 0x00 0x00 0x30 0x00 0x01 0x00 0x01 0x00 0x00 0x31 0x00 0x01 0x00 0x01 0x00 0x00 0x32 0x00 0x01 0x00 0x01 0x00 0x01 0x33 0x00 0x01 0x00 0x01 0x00 0x01 0x34 0x00 0x00 0x00 0x01 0x01 0x01 0x35 0x02 0x00 0x00 0x01 0x00 0x01 0x36 0x00 0x01 0x00 0x01 0x00 0x00 0x37 0x00 0x01 0x00 0x01 0x00 0x00 0x38 0x00 0x01 0x00 0x01 0x00 0x00 0x39 0x00 0x00 0x00 0x01 0x00 0x00 0x3a 0x00 0x00 0x00 0x01 0x00 0x00 0x3b 0x00 0x01 0x00 0x01 0x00 0x00 0x3c 0x00 0x00 0x00 0x01 0x01 0x00 0x3d 0x00 0x01 0x00 0x01 0x00 0x00 0x3e 0x00 0x01 0x01 0x01 0x00 0x00 0x3f 0x00 0x01 0x00 0x01 0x00 0x00 0x40 0x00 0x01 0x00 0x01 0x00 0x01 0x41 0x00 0x01 0x00 0x01 0x00 0x00 0x42 0x01 0x00 0x00 0x01 0x01 0x01 0x43 0x01 0x00 0x00 0x01 0x01 0x01 0x44 0x05 0x00 0x00 0x01 0x00 0x00 0x45 0x00 0x00 0x00 0x01 0x01 0x01 0x4a 0x00 0x01 0x01 0x01 0x00 0x00 0x4b 0x00 0x01 0x00 0x01 0x00 0x01 0x4d 0x01 0x00 0x00 0x00 0x00 0x01 0x4e 0x01 0x00 0x00 0x00 0x00 0x01 0x4f 0x01 0x00 0x00 0x01 0x01 0x01 0x50 0x01 0x00 0x00 0x00 0x00 0x01 0x51 0x01 0x00 0x00 0x00 0x00 0x01 0x52 0x01 0x00 0x00 0x01 0x01 0x01 0x53 0x01 0x00 0x00 0x01 0x00 0x01 0x54 0x00 0x01 0x00 0x01 0x00 0x01 0x55 0x00 0x01 0x00 0x01 0x00 0x01 0x56 0x01 0x00 0x00 0x01 0x00 0x00 0x57 0x01 0x00 0x00 0x01 0x00 0x00 0x58 0x01 0x00 0x00 0x01 0x00 0x00 0x59 0x01 0x00 0x00 0x01 0x00 0x00 0x5a 0x01 0x00 0x00 0x01 0x00 0x00 0x5b 0x01 0x00 0x00 0x01 0x00 0x00 0x5c 0x01 0x00 0x00 0x01 0x00 0x00 0x5d 0x01 0x00 0x00 0x01 0x00 0x00 0x5e 0x01 0x00 0x00 0x01 0x00 0x00 0x5f 0x01 0x00 0x00 0x01 0x00 0x00 0x60 0x01 0x00 0x00 0x01 0x00 0x00 0x61 0x01 0x00 0x00 0x01 0x00 0x00 0x62 0x01 0x00 0x00 0x01 0x00 0x00 0x63 0x01 0x00 0x00 0x01 0x00 0x00 0x64 0x01 0x00 0x00 0x01 0x00 0x00 0x65 0x01 0x00 0x00 0x01 0x00 0x00 0x66 0x01 0x00 0x00 0x01 0x00 0x00 0x67 0x01 0x00 0x00 0x01 0x00 0x00 0x68 0x01 0x00 0x00 0x01 0x00 0x00 0x69 0x01 0x00 0x00 0x01 0x00 0x00 0x6a 0x01 0x00 0x00 0x01 0x00 0x00 0x6b 0x01 0x00 0x00 0x01 0x00 0x00 0x6c 0x01 0x00 0x00 0x01 0x00 0x00 0x6d 0x01 0x00 0x00 0x01 0x00 0x00 0x6e 0x01 0x00 0x00 0x01 0x00 0x00 0x6f 0x01 0x00 0x00 0x01 0x00 0x00 0x70 0x01 0x00 0x00 0x01 0x00 0x00 0x71 0x01 0x00 0x00 0x01 0x00 0x00 0x72 0x01 0x00 0x00 0x01 0x00 0x00 0x73 0x01 0x00 0x00 0x01 0x00 0x00 0x74 0x00 0x00 0x00 0x01 0x00 0x00 0x75 0x00 0x00 0x00 0x01 0x00 0x00 0x76 0x00 0x01 0x00 0x01 0x00 0x00 0x77 0x00 0x00 0x00 0x01 0x00 0x00 0x78 0x01 0x00 0x00 0x01 0x00 0x00 0x79 0x01 0x00 0x00 0x01 0x00 0x00 0x7a 0x01 0x00 0x00 0x00 0x00 0x00 0x7b 0x01 0x00 0x00 0x00 0x00 0x00 0x7c 0x01 0x00 0x00 0x01 0x00 0x00 0x7d 0x01 0x00 0x00 0x01 0x00 0x00 0x7e 0x01 0x00 0x00 0x01 0x00 0x00 0x7f 0x01 0x00 0x00 0x01 0x00 0x00 0x80 0x01 0x00 0x00 0x01 0x00 0x00 0x81 0x01 0x00 0x00 0x01 0x00 0x00 0x82 0x01 0x00 0x00 0x01 0x01 0x01 0x83 0x01 0x00 0x00 0x01 0x01 0x01 0x84 0x02 0x00 0x00 0x01 0x01 0x00 0x85 0x02 0x00 0x00 0x01 0x01 0x00 0x86 0x01 0x00 0x00 0x01 0x01 0x01 0x87 0x01 0x00 0x00 0x01 0x01 0x01 0x88 0x01 0x00 0x00 0x01 0x01 0x01 0x89 0x01 0x00 0x00 0x01 0x01 0x01 0x8a 0x01 0x00 0x00 0x01 0x01 0x01 0x8b 0x01 0x00 0x00 0x01 0x01 0x01 0x8c 0x01 0x00 0x00 0x01 0x01 0x01 0x8d 0x01 0x00 0x00 0x01 0x01 0x01 0x8e 0x01 0x00 0x00 0x01 0x01 0x01 0x8f 0x01 0x00 0x00 0x01 0x01 0x01 0x90 0x01 0x00 0x00 0x01 0x01 0x01 0x91 0x01 0x00 0x00 0x01 0x01 0x01 0x92 0x01 0x00 0x00 0x01 0x01 0x01 0x93 0x01 0x00 0x00 0x01 0x01 0x01 0x94 0x02 0x00 0x00 0x01 0x01 0x01 0x95 0x02 0x00 0x00 0x01 0x01 0x01 0x96 0x00 0x01 0x00 0x01 0x00 0x00 0x97 0x00 0x01 0x00 0x01 0x00 0x01 0x98 0x00 0x01 0x00 0x01 0x00 0x01 0x99 0x00 0x01 0x00 0x01 0x00 0x01 0x9a 0x00 0x01 0x00 0x01 0x00 0x01 0x9b 0x00 0x01 0x00 0x01 0x00 0x01 0x9c 0x00 0x01 0x00 0x01 0x00 0x01 0x9d 0x00 0x01 0x00 0x01 0x00 0x01 0x9e 0x06 0x00 0x00 0x01 0x00 0x00 0x9f 0x02 0x00 0x00 0x00 0x00 0x00 0xa0 0x01 0x00 0x00 0x00 0x00 0x01 0xa1 0x01 0x00 0x00 0x00 0x00 0x01 0xa2 0x01 0x00 0x00 0x00 0x00 0x01 0xa3 0x01 0x00 0x00 0x01 0x00 0x01 0xa4 0x01 0x00 0x00 0x00 0x00 0x01 0xa5 0x01 0x00 0x00 0x00 0x00 0x01 0xa6 0x01 0x00 0x00 0x00 0x00 0x01 0xa7 0x01 0x00 0x00 0x01 0x00 0x01 0xa8 0x01 0x00 0x00 0x00 0x00 0x00 0xa9 0x01 0x00 0x00 0x00 0x00 0x01 0xaa 0x01 0x00 0x00 0x00 0x00 0x01 0xab 0x01 0x00 0x00 0x00 0x00 0x01 0xac 0x01 0x00 0x00 0x00 0x00 0x01 0xad 0x01 0x00 0x00 0x01 0x00 0x01 0xae 0x01 0x00 0x00 0x01 0x00 0x01 0xaf 0x01 0x00 0x00 0x01 0x00 0x01 0xb0 0x01 0x00 0x00 0x01 0x00 0x01 0xb1 0x00 0x00 0x00 0x01 0x00 0x00 0xb2 0x00 0x00 0x00 0x01 0x00 0x00 0xb3 0x00 0x00 0x00 0x01 0x00 0x00 0xb4 0x00 0x00 0x00 0x01 0x00 0x00 0xb5 0x00 0x00 0x00 0x01 0x00 0x00 0xb6 0x00 0x00 0x00 0x01 0x00 0x00 0xb7 0x00 0x00 0x00 0x01 0x00 0x00 0xb8 0x00 0x00 0x00 0x01 0x00 0x00 0xb9 0x00 0x00 0x00 0x01 0x00 0x00 0xba 0x01 0x00 0x00 0x01 0x01 0x01 0xbb 0x01 0x00 0x00 0x01 0x01 0x01 0xbc 0x00 0x00 0x00 0x01 0x00 0x00 0xbd 0x00 0x00 0x00 0x01 0x00 0x00 0xbe 0x00 0x00 0x00 0x01 0x00 0x00 0xbf 0x00 0x00 0x00 0x01 0x00 0x00 0xc0 0x00 0x00 0x00 0x01 0x00 0x00 0xc1 0x00 0x00 0x00 0x01 0x00 0x00 0xc2 0x00 0x00 0x00 0x01 0x00 0x00 0xc3 0x00 0x00 0x00 0x01 0x00 0x00 0xc4 0x00 0x00 0x00 0x01 0x00 0x00 0xc5 0x00 0x00 0x00 0x01 0x00 0x00 0xc6 0x00 0x00 0x00 0x01 0x00 0x00 0xc7 0x00 0x00 0x00 0x01 0x00 0x00 0xc8 0x00 0x00 0x00 0x01 0x00 0x00 0xc9 0x00 0x00 0x00 0x01 0x00 0x00 0xca 0x00 0x00 0x00 0x01 0x00 0x00 0xcb 0x00 0x00 0x00 0x01 0x00 0x00 0xcc 0x00 0x00 0x00 0x01 0x00 0x00 0xcd 0x00 0x00 0x00 0x01 0x00 0x00 0xce 0x00 0x00 0x00 0x01 0x00 0x00 0xcf 0x00 0x00 0x00 0x01 0x00 0x00 0xd0 0x00 0x00 0x00 0x01 0x00 0x00 0xd1 0x00 0x00 0x00 0x01 0x00 0x00 0xd2 0x00 0x00 0x00 0x01 0x00 0x00 0xd3 0x00 0x00 0x00 0x01 0x00 0x00 0xd4 0x00 0x00 0x00 0x01 0x00 0x00 0xd5 0x00 0x00 0x00 0x01 0x00 0x00 0xd6 0x00 0x00 0x00 0x01 0x00 0x00 0xd7 0x00 0x00 0x00 0x01 0x00 0x00 0xd8 0x00 0x00 0x00 0x01 0x00 0x00 0xd9 0x00 0x00 0x00 0x01 0x00 0x00 0xda 0x00 0x00 0x00 0x01 0x00 0x00 0xdb 0x00 0x00 0x00 0x01 0x00 0x00 0xdc 0x00 0x00 0x00 0x01 0x00 0x00 0xdd 0x00 0x00 0x00 0x01 0x00 0x00>;
		};
	};

	fragment@66 {
		target = <0xffffffff>;

		__overlay__ {
			interrupt-parent = <0xffffffff>;
			interrupts = <0x05 0x02>;
			status = "okay";
		};
	};

	fragment@67 {
		target = <0xffffffff>;

		__overlay__ {
			interrupt-parent = <0xffffffff>;
			interrupts = <0x06 0x08>;
			status = "okay";
		};
	};

	fragment@68 {
		target = <0xffffffff>;

		__overlay__ {
			interrupt-parent = <0xffffffff>;
			interrupts = <0x09 0x02>;
			status = "okay";
		};
	};

	fragment@69 {
		target = <0xffffffff>;

		__overlay__ {
			interrupt-parent = <0xffffffff>;
			interrupts = <0x53 0x01>;
			status = "okay";
		};
	};

	fragment@70 {
		target = <0xffffffff>;

		__overlay__ {
			compatible = "mediatek,md1_sim1_hot_plug_eint-eint";
			interrupts = <0x00 0x08>;
			debounce = <0x00 0x4e20>;
			dedicated = <0x00 0x00>;
			src_pin = <0x00 0x01>;
			sockettype = <0x00 0x00>;
			status = "okay";
		};
	};

	fragment@71 {
		target = <0xffffffff>;

		__overlay__ {
			mediatek,key-debounce = <0x400>;
			mediatek,sw-pwrkey = <0x74>;
			mediatek,hw-pwrkey = <0x08>;
			mediatek,use-extend-type = <0x00>;
			mediatek,hw-map-num = <0x48>;
			mediatek,hw-init-map = <0x73 0x72 0x00 0x00 0x00 0x00 0x00 0x00 0x00 0x00 0x00 0x00 0x00 0x00 0x00 0x00 0x00 0x00 0x00 0x00 0x00 0x00 0x00 0x00 0x00 0x00 0x00 0x00 0x00 0x00 0x00 0x00 0x00 0x00 0x00 0x00 0x00 0x00 0x00 0x00 0x00 0x00 0x00 0x00 0x00 0x00 0x00 0x00 0x00 0x00 0x00 0x00 0x00 0x00 0x00 0x00 0x00 0x00 0x00 0x00 0x00 0x00 0x00 0x00 0x00 0x00 0x00 0x00 0x00 0x00 0x00 0x00>;
			mediatek,pwrkey-eint-gpio = <0x00>;
			mediatek,pwkey-gpio-din = <0x00>;
			mediatek,hw-dl-key0 = <0x00>;
			mediatek,hw-dl-key1 = <0x01>;
			mediatek,hw-dl-key2 = <0x08>;
			mediatek,hw-recovery-key = <0x00>;
			mediatek,hw-factory-key = <0x01>;
			status = "okay";
		};
	};

	__symbols__ {
		camera_pins_cam0_mclk_off = "/fragment@0/__overlay__/camera_pins_cam0_mclk_off";
		camera_pins_cam0_mclk_2ma = "/fragment@0/__overlay__/camera_pins_cam0_mclk_2ma";
		camera_pins_cam0_mclk_4ma = "/fragment@0/__overlay__/camera_pins_cam0_mclk_4ma";
		camera_pins_cam0_mclk_6ma = "/fragment@0/__overlay__/camera_pins_cam0_mclk_6ma";
		camera_pins_cam0_mclk_8ma = "/fragment@0/__overlay__/camera_pins_cam0_mclk_8ma";
		camera_pins_cam1_mclk_off = "/fragment@0/__overlay__/camera_pins_cam1_mclk_off";
		camera_pins_cam1_mclk_2ma = "/fragment@0/__overlay__/camera_pins_cam1_mclk_2ma";
		camera_pins_cam1_mclk_4ma = "/fragment@0/__overlay__/camera_pins_cam1_mclk_4ma";
		camera_pins_cam1_mclk_6ma = "/fragment@0/__overlay__/camera_pins_cam1_mclk_6ma";
		camera_pins_cam1_mclk_8ma = "/fragment@0/__overlay__/camera_pins_cam1_mclk_8ma";
		camera_pins_default = "/fragment@0/__overlay__/camdefault";
		flashlights_aw36515 = "/fragment@2/__overlay__/flashlights_aw36515";
		flashlight_gpio157 = "/fragment@2/__overlay__/flashlight_gpio157";
		cam0vcamio_gpio62 = "/fragment@2/__overlay__/cam0vcamio_gpio62";
		cam0rst_gpio18 = "/fragment@2/__overlay__/cam0rst_gpio18";
		cam1vcamd_gpio46 = "/fragment@2/__overlay__/cam1vcamd_gpio46";
		cam1rst_gpio16 = "/fragment@2/__overlay__/cam1rst_gpio16";
		mtk_camera_eeprom0 = "/fragment@3/__overlay__/camera_eeprom0@50";
		camera_main_mtk = "/fragment@3/__overlay__/camera_main@1a";
		camera_main_af_mtk = "/fragment@3/__overlay__/camera_main_af@0c";
		mtk_camera_eeprom1 = "/fragment@4/__overlay__/camera_eeprom1@51";
		camera_sub_mtk = "/fragment@4/__overlay__/camera_sub@1a";
		TRANLDO13 = "/fragment@5/__overlay__/tran_ldo@28/regulators/TRANLDO13";
		TRANLDO23 = "/fragment@5/__overlay__/tran_ldo@28/regulators/TRANLDO23";
		TRANLDO33 = "/fragment@5/__overlay__/tran_ldo@28/regulators/TRANLDO33";
		TRANLDO43 = "/fragment@5/__overlay__/tran_ldo@28/regulators/TRANLDO43";
		strobe_main_mtk = "/fragment@6/__overlay__/strobe_main@63";
		camera_main = "/fragment@7/__overlay__/camera_main";
		camera_sub = "/fragment@7/__overlay__/camera_sub";
		pd_adapter = "/pd_adapter";
		led6 = "/fragment@10/__overlay__/led@6";
		fingerprint = "/fragment@10/__overlay__/fingerprint";
		fingerprint_default = "/fragment@12/__overlay__/fingerprint_default";
		fingerprint_eint = "/fragment@12/__overlay__/gpio13_eint";
		fingerprint_eint_pull_down = "/fragment@12/__overlay__/gpio13_eint_pull_down";
		fingerprint_rst_one = "/fragment@12/__overlay__/rst_out_one";
		fingerprint_rst_zero = "/fragment@12/__overlay__/rst_out_zero";
		fingerprint_spi_default = "/fragment@12/__overlay__/spimode_default";
		mtkfb_pins_lcm_reset0 = "/fragment@13/__overlay__/lcm_rst_out0_gpio";
		mtkfb_pins_lcm_reset1 = "/fragment@13/__overlay__/lcm_rst_out1_gpio";
		mtkfb_pins_lcm_dsi_te = "/fragment@13/__overlay__/lcm_dsi_te";
		panel_in1 = "/fragment@21/__overlay__/panel1@0/port/endpoint";
		panel_in2 = "/fragment@21/__overlay__/panel2@0/port/endpoint";
		dsi_out = "/fragment@21/__overlay__/ports/port/endpoint";
		gps_pins_default = "/fragment@24/__overlay__/gps_default";
		gps_l1_lna_pins_ol = "/fragment@24/__overlay__/gps_l1_lna@0";
		gps_l1_lna_pins_dsp_ctrl = "/fragment@24/__overlay__/gps_l1_lna@1";
		gps_l1_lna_pins_oh = "/fragment@24/__overlay__/gps_l1_lna@2";
		tms_nfc = "/fragment@26/__overlay__/tms_nfc@28";
		gpio_keys = "/fragment@27/__overlay__/gpio_keys";
		tran_touch = "/fragment@29/__overlay__/touch@0";
		leds_i2c_clk_mode = "/fragment@33/__overlay__/leds_i2c_clk_mode";
		leds_i2c_sda_mode = "/fragment@33/__overlay__/leds_i2c_sda_mode";
		was4783 = "/fragment@34/__overlay__/was4783@42";
		tran_audio = "/fragment@35/__overlay__/tran_audio";
		tran_battery = "/fragment@39/__overlay__/tran_battery";
		tran_battery_aging = "/fragment@39/__overlay__/tran_battery_aging";
		tran_otg = "/fragment@39/__overlay__/tran_otg";
		tran_auto_test = "/fragment@39/__overlay__/tran_auto_test";
		pid_chg = "/fragment@39/__overlay__/pid_chg";
		ambient_detect = "/fragment@39/__overlay__/ambient_detect";
		temp_forecast = "/fragment@39/__overlay__/temp_forecast";
		port_corrosion = "/fragment@39/__overlay__/port_corrosion";
		phy_insert_det = "/fragment@39/__overlay__/phy_insert_det";
		switch_chg = "/fragment@49/__overlay__/sc-swchg@6b";
		otg_vbus = "/fragment@49/__overlay__/sc-swchg@6b/usb-otg-vbus";
		usb_control = "/fragment@57/__overlay__/usb_control";
		default = "/fragment@58/__overlay__/default";
		hvdcp_handshake = "/fragment@58/__overlay__/hvdcp_handshake";
		hvdcp_boost_5v = "/fragment@58/__overlay__/hvdcp_boost_5v";
		hvdcp_boost_9v = "/fragment@58/__overlay__/hvdcp_boost_9v";
		hvdcp_reset = "/fragment@58/__overlay__/hvdcp_reset";
		tc30_handshake = "/fragment@58/__overlay__/tc30_handshake";
		tc30_reset = "/fragment@58/__overlay__/tc30_reset";
		rfc_i2c_mode = "/fragment@58/__overlay__/rfc_i2c_mode";
		rfc_dual_high = "/fragment@58/__overlay__/rfc_dual_high";
		rfc_high_low = "/fragment@58/__overlay__/rfc_high_low";
		rfc_reset = "/fragment@58/__overlay__/rfc_reset";
		rfc_usb_switch_on = "/fragment@58/__overlay__/usb_switch_on";
		rfc_usb_switch_off = "/fragment@58/__overlay__/usb_switch_off";
		ta_off = "/fragment@58/__overlay__/ta_off";
		ta_reset = "/fragment@58/__overlay__/ta_reset";
		rt1711_typec = "/fragment@59/__overlay__/usb_type_c@4e";
		usb_switch = "/fragment@60/__overlay__/usb_switch";
		gpio_i2c_sclk_mode = "/fragment@62/__overlay__/i2c_sclk_mode";
		gpio_i2c_sda_mode = "/fragment@62/__overlay__/i2c_sda_mode";
	};

	__fixups__ {
		pio = "/fragment@0:target:0", "/fragment@1/__overlay__:camera_input_gpio:0", "/fragment@2/__overlay__/flashlight_gpio157:gpio:0", "/fragment@2/__overlay__/cam0vcamio_gpio62:gpio:0", "/fragment@2/__overlay__/cam0rst_gpio18:gpio:0", "/fragment@2/__overlay__/cam1vcamd_gpio46:gpio:0", "/fragment@2/__overlay__/cam1rst_gpio16:gpio:0", "/fragment@10/__overlay__/fingerprint:interrupt-parent:0", "/fragment@11/__overlay__/fingerprint@0:interrupt-parent:0", "/fragment@11/__overlay__/fingerprint@0:irq-gpio-std:0", "/fragment@11/__overlay__/fingerprint@0:reset-gpio-std:0", "/fragment@11/__overlay__/fingerprint@0:tran,gpio_pwr-std:0", "/fragment@12:target:0", "/fragment@13:target:0", "/fragment@21/__overlay__/panel1@0:vddi-gpios:0", "/fragment@21/__overlay__/panel1@0:vci-gpios:0", "/fragment@21/__overlay__/panel1@0:reset-gpios:0", "/fragment@21/__overlay__/panel2@0:vddi-gpios:0", "/fragment@21/__overlay__/panel2@0:vci-gpios:0", "/fragment@21/__overlay__/panel2@0:reset-gpios:0", "/fragment@24:target:0", "/fragment@26/__overlay__/tms_nfc@28:tms,irq-gpio:0", "/fragment@26/__overlay__/tms_nfc@28:tms,ven-gpio:0", "/fragment@26/__overlay__/tms_nfc@28:tms,download-gpio:0", "/fragment@27/__overlay__/gpio_keys/aikey:gpios:0", "/fragment@29/__overlay__/touch@0:chipsemi,int-gpio:0", "/fragment@29/__overlay__/touch@0:chipsemi,rst-gpio:0", "/fragment@29/__overlay__/touch@0:chipsemi,vdd-gpio:0", "/fragment@29/__overlay__/touch@0:chipsemi,vddio-gpio:0", "/fragment@29/__overlay__/touch@0:focaltech,irq-gpio:0", "/fragment@29/__overlay__/touch@0:focaltech,reset-gpio:0", "/fragment@29/__overlay__/touch@0:focaltech,iovdd-gpio:0", "/fragment@29/__overlay__/touch@0:focaltech,avdd-gpio:0", "/fragment@30/__overlay__:interrupts-extended:0", "/fragment@32/__overlay__/aw20198_led@20:enable-gpio:0", "/fragment@33:target:0", "/fragment@35:target:0", "/fragment@35/__overlay__/tran_audio:typec_usb_change_gpio:0", "/fragment@39/__overlay__/phy_insert_det:phy,intr-gpio:0", "/fragment@47/__overlay__/upm7610@60:upm7610pd,intr_gpio:0", "/fragment@48/__overlay__/sc8548_master@6F:sc8548,intr-gpios:0", "/fragment@49/__overlay__/sc-swchg@6b:sc8950,intr_gpio:0", "/fragment@49/__overlay__/sc-swchg@6b:sgm41516d,intr_gpio:0", "/fragment@49/__overlay__/sc-swchg@6b:interrupts-extended:0", "/fragment@54/__overlay__/hl7139a_master@5f:hl7139a,intr-gpios:0", "/fragment@58:target:0", "/fragment@59/__overlay__/usb_type_c@4e:rt1711pd,intr_gpio:0", "/fragment@62:target:0", "/fragment@64/__overlay__:GPIO_SIM1_HOT_PLUG:0", "/fragment@64/__overlay__:GPIO_SIM1_SCLK:0", "/fragment@64/__overlay__:GPIO_SIM1_SRST:0", "/fragment@64/__overlay__:GPIO_SIM1_SIO:0", "/fragment@64/__overlay__:GPIO_SIM2_SCLK:0", "/fragment@64/__overlay__:GPIO_SIM2_SRST:0", "/fragment@64/__overlay__:GPIO_SIM2_SIO:0", "/fragment@66/__overlay__:interrupt-parent:0", "/fragment@67/__overlay__:interrupt-parent:0", "/fragment@68/__overlay__:interrupt-parent:0", "/fragment@69/__overlay__:interrupt-parent:0";
		kd_camera_hw1 = "/fragment@1:target:0";
		mt6358_vio28_reg = "/fragment@1/__overlay__:cam0_vcamaf-supply:0";
		odm = "/fragment@2:target:0", "/fragment@10:target:0", "/fragment@27:target:0", "/fragment@39:target:0", "/fragment@57:target:0", "/fragment@60:target:0";
		i2c2 = "/fragment@3:target:0", "/fragment@56:target:0";
		i2c4 = "/fragment@4:target:0";
		i2c3 = "/fragment@5:target:0", "/fragment@34:target:0", "/fragment@47:target:0", "/fragment@59:target:0";
		i2c6 = "/fragment@6:target:0", "/fragment@31:target:0";
		thermal_zones = "/fragment@7:target:0";
		chosen = "/fragment@8:target:0", "/fragment@39/__overlay__/tran_battery:bootmode:0", "/fragment@44/__overlay__:bootmode:0";
		mtk_leds = "/fragment@9:target:0";
		spi3 = "/fragment@11:target:0";
		mtkfb = "/fragment@14:target:0";
		disp_ccorr0 = "/fragment@15:target:0";
		dispsys_config = "/fragment@16:target:0";
		cpu_power_throttling = "/fragment@18:target:0";
		gpu_power_throttling = "/fragment@19:target:0";
		md_power_throttling = "/fragment@20:target:0";
		dsi0 = "/fragment@21:target:0";
		tran_sensor_cust = "/fragment@22:target:0";
		irtx_pwm = "/fragment@23:target:0";
		gps = "/fragment@25:target:0";
		i2c0 = "/fragment@26:target:0";
		touch = "/fragment@28:target:0", "/fragment@68:target:0";
		spi1 = "/fragment@29:target:0";
		rt5133 = "/fragment@30:target:0";
		i2c8 = "/fragment@32:target:0";
		scp_cust = "/fragment@36:target:0";
		pdc = "/fragment@37:target:0", "/fragment@43:target:0";
		u2port0 = "/fragment@38:target:0", "/fragment@49/__overlay__/sc-swchg@6b:phys:0";
		pe2 = "/fragment@40:target:0";
		tc30 = "/fragment@41:target:0";
		hvdcp20 = "/fragment@42:target:0";
		extcon_usb = "/fragment@44:target:0", "/fragment@50:target:0";
		charger = "/fragment@45:target:0", "/fragment@52:target:0";
		auxadc = "/fragment@45/__overlay__:io-channels:0", "/fragment@63:target:0";
		lk_charger = "/fragment@46:target:0";
		i2c7 = "/fragment@48:target:0", "/fragment@54:target:0", "/fragment@61:target:0";
		i2c5 = "/fragment@49:target:0";
		usb = "/fragment@49/__overlay__/sc-swchg@6b:usb:0";
		mtk_ctd = "/fragment@51:target:0";
		mtk_gauge = "/fragment@53:target:0", "/fragment@55/__overlay__:gauge:0";
		pe5 = "/fragment@55:target:0";
		gpio_usage_mapping = "/fragment@64:target:0";
		gpio = "/fragment@65:target:0";
		rt5133_eint = "/fragment@66:target:0";
		smart_pa = "/fragment@67:target:0";
		dsi_te = "/fragment@69:target:0";
		md1_sim1_hot_plug_eint = "/fragment@70:target:0";
		keypad = "/fragment@71:target:0";
	};

	__local_fixups__ {

		fragment@1 {

			__overlay__ {
				pinctrl-0 = <0x00>;
				pinctrl-1 = <0x00>;
				pinctrl-2 = <0x00>;
				pinctrl-3 = <0x00>;
				pinctrl-4 = <0x00>;
				pinctrl-5 = <0x00>;
				pinctrl-6 = <0x00>;
				pinctrl-7 = <0x00>;
				pinctrl-8 = <0x00>;
				pinctrl-9 = <0x00>;
				pinctrl-10 = <0x00>;
				cam0_vcama-supply = <0x00>;
				cam0_vcamd-supply = <0x00>;
				cam0_vcamio-supply = <0x00>;
				cam0_vcamrst-supply = <0x00>;
				cam1_vcama-supply = <0x00>;
				cam1_vcamd-supply = <0x00>;
				cam1_vcamio-supply = <0x00>;
				cam1_vcamrst-supply = <0x00>;
			};
		};

		fragment@2 {

			__overlay__ {

				flashlights_aw36515 {
					aw36515_regulator-supply = <0x00>;
				};
			};
		};

		fragment@7 {

			__overlay__ {

				camera_main {
					thermal-sensors = <0x00>;
				};

				camera_sub {
					thermal-sensors = <0x00>;
				};
			};
		};

		fragment@10 {

			__overlay__ {

				fingerprint {
					pinctrl-0 = <0x00>;
					pinctrl-1 = <0x00>;
					pinctrl-2 = <0x00>;
					pinctrl-3 = <0x00>;
					pinctrl-4 = <0x00>;
					pinctrl-5 = <0x00>;
				};
			};
		};

		fragment@11 {

			__overlay__ {

				fingerprint@0 {
					pinctrl-0 = <0x00>;
					pinctrl-1 = <0x00>;
					pinctrl-2 = <0x00>;
					pinctrl-3 = <0x00>;
					pinctrl-4 = <0x00>;
					pinctrl-5 = <0x00>;
				};
			};
		};

		fragment@14 {

			__overlay__ {
				pinctrl-1 = <0x00>;
				pinctrl-2 = <0x00>;
				pinctrl-3 = <0x00>;
			};
		};

		fragment@16 {

			__overlay__ {
				pinctrl-1 = <0x00>;
				pinctrl-2 = <0x00>;
				pinctrl-3 = <0x00>;
			};
		};

		fragment@21 {

			__overlay__ {

				panel1@0 {
					dvdd-supply = <0x00>;

					port {

						endpoint {
							remote-endpoint = <0x00>;
						};
					};
				};

				panel2@0 {
					dvdd-supply = <0x00>;

					port {

						endpoint {
							remote-endpoint = <0x00>;
						};
					};
				};

				ports {

					port {

						endpoint {
							remote-endpoint = <0x00>;
						};
					};
				};
			};
		};

		fragment@25 {

			__overlay__ {
				pinctrl-0 = <0x00>;
				pinctrl-1 = <0x00>;
				pinctrl-2 = <0x00>;
				pinctrl-3 = <0x00>;
			};
		};

		fragment@32 {

			__overlay__ {

				aw20198_led@20 {
					pinctrl-0 = <0x00>;
					pinctrl-1 = <0x00>;
				};
			};
		};

		fragment@44 {

			__overlay__ {
				charger = <0x00>;
			};
		};

		fragment@45 {

			__overlay__ {
				charger = <0x00>;
			};
		};

		fragment@50 {

			__overlay__ {
				charger = <0x00>;
			};
		};

		fragment@51 {

			__overlay__ {
				bc12 = <0x00>;
			};
		};

		fragment@52 {

			__overlay__ {
				charger = <0x00>;
			};
		};

		fragment@53 {

			__overlay__ {
				charger = <0x00>;
			};
		};

		fragment@55 {

			__overlay__ {
				charger = <0x00>;
			};
		};

		fragment@57 {

			__overlay__ {

				usb_control {
					pinctrl-0 = <0x00>;
					pinctrl-1 = <0x00>;
					pinctrl-2 = <0x00>;
					pinctrl-3 = <0x00>;
					pinctrl-4 = <0x00>;
					pinctrl-5 = <0x00>;
					pinctrl-6 = <0x00>;
					pinctrl-7 = <0x00>;
					pinctrl-8 = <0x00>;
					pinctrl-9 = <0x00>;
					pinctrl-10 = <0x00>;
					pinctrl-11 = <0x00>;
					pinctrl-12 = <0x00>;
					pinctrl-13 = <0x00>;
					pinctrl-14 = <0x00>;
				};
			};
		};

		fragment@61 {

			__overlay__ {

				rfc_ta@1b {
					pinctrl-0 = <0x00>;
					pinctrl-1 = <0x00>;
				};
			};
		};
	};
};
